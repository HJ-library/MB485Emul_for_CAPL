/*@!Encoding:949*/
includes
{
     #include "M485E_Control.cin"
}

// UI는 Panel/System Variable 입력을 요청으로 변환하고 처리 결과를 다시 표시한다.
// DLL을 직접 호출하지 않으며 Core 또는 Monitoring의 공개 CAPL 함수만 사용한다.

variables
{
     // 수동 Register Write 요청과 최대 125개의 word 데이터를 함께 보관한다.
     struct M485E_ManualWriteRequest
     {
          long index;
          long startAddress;
          long quantity;
          word data[125];
     };

     // Signal Panel의 공통 입력값이다. Read와 Write 이벤트가 같은 로더를 사용한다.
     struct M485E_SignalRequest
     {
          long index;
          char signalName[128];
          float physicalValue;
     };

     long gM485E_UILongData[125];
     long gM485E_ReadOptionValues[200];
     struct M485E_SignalRequest gM485E_SignalRequest;
     // Panel의 ReadOption 후보를 Monitoring 상태로 동기화한다.
     msTimer tM485E_UISync;
}

/*
 * 함수명: M485E_UI_LoadSignalRequest
 * 기능: SignalControl 입력을 한 요청 구조체로 복사하여 이벤트 처리 중 값 변경을 격리한다.
 * 파라미터: 없음
 */
void M485E_UI_LoadSignalRequest()
{
     gM485E_SignalRequest.index = @sysvar::M485E::SignalControl::Index;
     sysGetVariableString(sysvar::M485E::SignalControl::SignalName,
          gM485E_SignalRequest.signalName,
          elcount(gM485E_SignalRequest.signalName));
     gM485E_SignalRequest.physicalValue =
          @sysvar::M485E::SignalControl::PhysicalValue;
}

/*
 * 함수명: M485E_UI_ExecuteWrite
 * 기능: 준비된 Register Write 요청을 Core에 전달하고 결과를 Panel에 반영한다.
 * 파라미터: request - Device Index, 시작 Address, Quantity와 16-bit Register 배열
 * 반환값: M485E_OK 또는 Register Write 오류 코드
 */
long M485E_UI_ExecuteWrite(struct M485E_ManualWriteRequest request)
{
     long result;
     result = M485E_Core_WriteRegisters(request.index, request.startAddress,
          request.quantity, request.data);
     @sysvar::M485E::ManualWrite::ResultCode = result;
     M485E_Core_ReportSyncFailure("ManualWrite", result);
     return result;
}

// 이벤트명: ManualWrite::Send 변경
// 기능: 32-bit System Variable 배열을 검증하여 Modbus 16-bit Register Write를 실행한다.
on sysvar_update sysvar::M485E::ManualWrite::Send
{
     struct M485E_ManualWriteRequest request;
     long dataLength;
     long index;
     if (@this == 0) return;
     request.index = @sysvar::M485E::ManualWrite::Index;
     request.startAddress = @sysvar::M485E::ManualWrite::StartAddress;
     request.quantity = @sysvar::M485E::ManualWrite::Quantity;
     dataLength = SysGetVariableArrayLength(sysvar::M485E::ManualWrite::Data);
     // 회사 Configuration의 실제 Data 배열 길이를 기준으로 검사하여 정의되지 않은
     // 배열 원소나 이전 요청의 잔존값이 Register에 기록되는 것을 막는다.
     if (request.quantity < 1 || request.quantity > dataLength ||
          dataLength > elcount(gM485E_UILongData) ||
          request.quantity > elcount(request.data))
     {
          @sysvar::M485E::ManualWrite::ResultCode = M485E_ERR_INVALID_ARGUMENT;
          M485E_Core_ReportSyncFailure("ManualWrite", M485E_ERR_INVALID_ARGUMENT);
          @this = 0;
          return;
     }
     sysGetVariableLongArray(sysvar::M485E::ManualWrite::Data,
          gM485E_UILongData, dataLength);
     for (index = 0; index < request.quantity; index++)
     {
          if (gM485E_UILongData[index] < 0 || gM485E_UILongData[index] > 65535)
          {
               @sysvar::M485E::ManualWrite::ResultCode = M485E_ERR_INVALID_ARGUMENT;
               M485E_Core_ReportSyncFailure("ManualWrite", M485E_ERR_INVALID_ARGUMENT);
               @this = 0;
               return;
          }
          request.data[index] = gM485E_UILongData[index];
     }
     M485E_UI_ExecuteWrite(request);
     @this = 0;
}

// 이벤트명: SignalControl::Read 변경
// 기능: SignalName으로 물리값을 읽고 성공한 경우에만 PhysicalValue를 갱신한다.
on sysvar_update sysvar::M485E::SignalControl::Read
{
     long result;
     if (@this == 0) return;
     M485E_UI_LoadSignalRequest();
     result = M485E_Core_ReadSignal(gM485E_SignalRequest.index,
          gM485E_SignalRequest.signalName,
          gM485E_SignalRequest.physicalValue);
     if (result == M485E_OK)
          @sysvar::M485E::SignalControl::PhysicalValue =
          gM485E_SignalRequest.physicalValue;
     @sysvar::M485E::SignalControl::ResultCode = result;
     M485E_Core_ReportSyncFailure("SignalRead", result);
     @this = 0;
}

// 이벤트명: SignalControl::Write 변경
// 기능: Panel 물리값을 Register Map의 Scale/Offset/Type 규칙에 따라 Signal에 쓴다.
on sysvar_update sysvar::M485E::SignalControl::Write
{
     long result;
     if (@this == 0) return;
     M485E_UI_LoadSignalRequest();
     result = M485E_Core_WriteSignal(gM485E_SignalRequest.index,
          gM485E_SignalRequest.signalName,
          gM485E_SignalRequest.physicalValue);
     @sysvar::M485E::SignalControl::ResultCode = result;
     M485E_Core_ReportSyncFailure("SignalWrite", result);
     @this = 0;
}

/*
 * 함수명: M485E_UI_SyncReadOptions
 * 기능: Check_ReadOption 전체를 Monitoring 후보 상태로 복사한다.
 * 파라미터: 없음
 * 반환값: M485E_OK 또는 ReadOption 슬롯 오류 코드
 */
long M485E_UI_SyncReadOptions()
{
     long index;
     long result;
     long readOptionCount;
     readOptionCount = M485E_Monitoring_GetReadOptionCount();
     // 후보 전체가 거부되면 Monitoring이 보관한 직전 Applied 상태를 먼저 Panel에 돌려준다.
     // 같은 Tick에서 거부된 값을 다시 읽지 않도록 복원 결과를 호출자에게 그대로 반환한다.
     if (M485E_Monitoring_HasCandidateRollback() != 0)
     {
          result = M485E_Monitoring_TakeCandidateRollback(
               gM485E_ReadOptionValues, elcount(gM485E_ReadOptionValues));
          if (result == M485E_ERR_BUFFER_TOO_SMALL) return result;
          sysSetVariableLongArray(sysvar::M485E::Monitoring::Check_ReadOption,
               gM485E_ReadOptionValues, readOptionCount);
          @sysvar::M485E::Monitoring::ResultCode = result;
          return result;
     }
     sysGetVariableLongArray(sysvar::M485E::Monitoring::Check_ReadOption,
          gM485E_ReadOptionValues, elcount(gM485E_ReadOptionValues));
     for (index = 0; index < readOptionCount; index++)
     {
          result = M485E_Monitoring_SetCandidate(index, gM485E_ReadOptionValues[index]);
          if (result != M485E_OK) return result;
     }
     return M485E_OK;
}

// 이벤트명: Monitoring::ReadSwitch 변경
// 기능: ON이면 최신 ReadOption으로 CAN Monitoring을 시작하고 OFF이면 중지한다.
on sysvar_update sysvar::M485E::Monitoring::ReadSwitch
{
     long result;
     if (@this != 0)
     {
          result = M485E_UI_SyncReadOptions();
          if (result == M485E_OK) result = M485E_Monitoring_Start();
     }
     else result = M485E_Monitoring_Stop();
     @sysvar::M485E::Monitoring::ResultCode = result;
     M485E_Core_ReportSyncFailure("Monitoring", result);
}

/*
 * 함수명: M485E_UI_Start
 * 기능: UI 동기화 Timer와 Connection Panel 상태 제어를 시작한다.
 * 파라미터: 없음
 */
void M485E_UI_Start()
{
     M485E_UI_SyncReadOptions();
     setTimer(tM485E_UISync, 100);
     M485E_Control_Start();
}

// 타이머명: tM485E_UISync
// 기능: 100ms마다 Check_ReadOption 배열을 복사하여 다음 Cycle에 한 묶음으로 반영한다.
on timer tM485E_UISync
{
     M485E_UI_SyncReadOptions();
     setTimer(tM485E_UISync, 100);
}

/*
 * 함수명: M485E_UI_Stop
 * 기능: Measurement 종료 시 UI와 Connection Panel 상태 Timer를 모두 중지한다.
 * 파라미터: 없음
 */
void M485E_UI_Stop()
{
     cancelTimer(tM485E_UISync);
     M485E_Control_Stop();
}
