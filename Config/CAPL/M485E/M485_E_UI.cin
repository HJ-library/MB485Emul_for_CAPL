/*@!Encoding:949*/

variables
{
  struct M485E_ManualReadRequest
  {
    long index;
    long startAddress;
    long quantity;
  };

  struct M485E_ManualWriteRequest
  {
    long index;
    long startAddress;
    long quantity;
    word data[125];
  };

  struct M485E_SignalRequest
  {
    long index;
    char signalName[128];
    float physicalValue;
  };

  struct M485E_ManualReadRequest gM485E_LastReadRequest;
  long gM485E_LastReadValid;
  word gM485E_UIWordData[125];
  long gM485E_UILongData[125];
  long gM485E_ReadOptionValues[200];
  struct M485E_SignalRequest gM485E_SignalRequest;
  msTimer tM485E_ManualAutoRead;
  msTimer tM485E_UISync;
  msTimer tM485E_LifecycleStatus;
  long gM485E_UILifecycleStatus[9];
}

void M485E_UI_LoadSignalRequest()
{
  gM485E_SignalRequest.index = @sysvar::M485E::SignalControl::Index;
  sysGetVariableString(sysvar::M485E::SignalControl::SignalName,
                       gM485E_SignalRequest.signalName,
                       elcount(gM485E_SignalRequest.signalName));
  gM485E_SignalRequest.physicalValue =
      @sysvar::M485E::SignalControl::PhysicalValue;
}

long M485E_UI_ExecuteRead(struct M485E_ManualReadRequest request)
{
  long result;
  long index;
  result = M485E_Core_ReadRegisters(request.index, request.startAddress,
                                    request.quantity, gM485E_UIWordData);
  if (result == M485E_OK)
  {
    for (index = 0; index < request.quantity; index++)
      gM485E_UILongData[index] = gM485E_UIWordData[index];
    sysSetVariableLongArray(sysvar::M485E::ManualRead::Data, gM485E_UILongData,
                            request.quantity);
    gM485E_LastReadRequest.index = request.index;
    gM485E_LastReadRequest.startAddress = request.startAddress;
    gM485E_LastReadRequest.quantity = request.quantity;
    gM485E_LastReadValid = 1;
  }
  @sysvar::M485E::ManualRead::ResultCode = result;
  M485E_Core_ReportSyncFailure("ManualRead", result);
  return result;
}

long M485E_UI_ExecuteWrite(struct M485E_ManualWriteRequest request)
{
  long result;
  result = M485E_Core_WriteRegisters(request.index, request.startAddress,
                                     request.quantity, request.data);
  @sysvar::M485E::ManualWrite::ResultCode = result;
  M485E_Core_ReportSyncFailure("ManualWrite", result);
  return result;
}

on sysvar_update sysvar::M485E::Connection::ConnectSwitch
{
  long result;
  if (@this != 0) result = M485E_Core_Connect();
  else result = M485E_Core_Disconnect();
  @sysvar::M485E::Connection::ResultCode = result;
  M485E_Core_ReportSyncFailure("Connection", result);
}

on sysvar_update sysvar::M485E::Connection::Refresh
{
  long result;
  if (@this == 0) return;
  result = M485E_Core_RefreshCsv();
  @sysvar::M485E::Connection::ResultCode = result;
  M485E_Core_ReportSyncFailure("RefreshCsv", result);
  @this = 0;
}

on sysvar_update sysvar::M485E::ManualRead::Send
{
  struct M485E_ManualReadRequest request;
  if (@this == 0) return;
  request.index = @sysvar::M485E::ManualRead::Index;
  request.startAddress = @sysvar::M485E::ManualRead::StartAddress;
  request.quantity = @sysvar::M485E::ManualRead::Quantity;
  M485E_UI_ExecuteRead(request);
  @this = 0;
}

on sysvar_update sysvar::M485E::ManualWrite::Send
{
  struct M485E_ManualWriteRequest request;
  long index;
  if (@this == 0) return;
  request.index = @sysvar::M485E::ManualWrite::Index;
  request.startAddress = @sysvar::M485E::ManualWrite::StartAddress;
  request.quantity = @sysvar::M485E::ManualWrite::Quantity;
  sysGetVariableLongArray(sysvar::M485E::ManualWrite::Data, gM485E_UILongData,
                          elcount(gM485E_UILongData));
  for (index = 0; index < request.quantity && index < elcount(request.data); index++)
  {
    if (gM485E_UILongData[index] < 0 || gM485E_UILongData[index] > 65535)
    {
      @sysvar::M485E::ManualWrite::ResultCode = M485E_ERR_INVALID_ARGUMENT;
      @this = 0;
      return;
    }
    request.data[index] = gM485E_UILongData[index];
  }
  M485E_UI_ExecuteWrite(request);
  @this = 0;
}

on sysvar_update sysvar::M485E::SignalControl::Read
{
  long result;
  if (@this == 0) return;
  M485E_UI_LoadSignalRequest();
  result = M485E_Core_ReadSignal(gM485E_SignalRequest.index,
                                 gM485E_SignalRequest.signalName,
                                 gM485E_SignalRequest.physicalValue);
  if (result == M485E_OK)
    @sysvar::M485E::SignalControl::PhysicalValue =
        gM485E_SignalRequest.physicalValue;
  @sysvar::M485E::SignalControl::ResultCode = result;
  M485E_Core_ReportSyncFailure("SignalRead", result);
  @this = 0;
}

on sysvar_update sysvar::M485E::SignalControl::Write
{
  long result;
  if (@this == 0) return;
  M485E_UI_LoadSignalRequest();
  result = M485E_Core_WriteSignal(gM485E_SignalRequest.index,
                                  gM485E_SignalRequest.signalName,
                                  gM485E_SignalRequest.physicalValue);
  @sysvar::M485E::SignalControl::ResultCode = result;
  M485E_Core_ReportSyncFailure("SignalWrite", result);
  @this = 0;
}

on sysvar_update sysvar::M485E::Monitoring::ReadSwitch
{
  long result;
  if (@this != 0) result = M485E_Monitoring_Start();
  else result = M485E_Monitoring_Stop();
  @sysvar::M485E::Monitoring::ResultCode = result;
  M485E_Core_ReportSyncFailure("Monitoring", result);
}

void M485E_UI_Start()
{
  setTimer(tM485E_ManualAutoRead, 1000);
  setTimer(tM485E_UISync, 100);
  setTimer(tM485E_LifecycleStatus, 100);
}

on timer tM485E_ManualAutoRead
{
  if (@sysvar::M485E::ManualRead::AutoReadManual != 0 && gM485E_LastReadValid != 0)
    M485E_UI_ExecuteRead(gM485E_LastReadRequest);
  setTimer(tM485E_ManualAutoRead, 1000);
}

on timer tM485E_UISync
{
  long index;
  long readOptionCount;
  sysGetVariableLongArray(sysvar::M485E::Monitoring::Check_ReadOption,
                          gM485E_ReadOptionValues, elcount(gM485E_ReadOptionValues));
  readOptionCount = M485E_Monitoring_GetReadOptionCount();
  for (index = 0; index < readOptionCount; index++)
    M485E_Monitoring_SetCandidate(index, gM485E_ReadOptionValues[index]);
  setTimer(tM485E_UISync, 100);
}

on timer tM485E_LifecycleStatus
{
  long result;
  result = M485E_Core_GetLifecycleStatus(gM485E_UILifecycleStatus);
  if (result == M485E_OK)
  {
    @sysvar::M485E::Connection::State =
        gM485E_UILifecycleStatus[M485E_LS_STATE];
    @sysvar::M485E::Connection::LastResult =
        gM485E_UILifecycleStatus[M485E_LS_LAST_RESULT];
    @sysvar::M485E::Connection::ConfigurationValid =
        gM485E_UILifecycleStatus[M485E_LS_CONFIGURATION_VALID];
  }
  M485E_Core_PollOneErrorEvent();
  setTimer(tM485E_LifecycleStatus, 100);
}

void M485E_UI_Stop()
{
  cancelTimer(tM485E_ManualAutoRead);
  cancelTimer(tM485E_UISync);
  cancelTimer(tM485E_LifecycleStatus);
}
