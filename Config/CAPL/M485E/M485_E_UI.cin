/*@!Encoding:949*/

// UI는 Panel/System Variable 입력을 요청으로 변환하고 처리 결과를 다시 표시한다.
// DLL을 직접 호출하지 않으며 Core 또는 Monitoring의 공개 CAPL 함수만 사용한다.

variables
{
     // 수동 Register Read 요청이다. Quantity는 16-bit Register 개수이다.
     struct M485E_ManualReadRequest
     {
          long index;
          long startAddress;
          long quantity;
     };

     // 수동 Register Write 요청과 최대 125개의 word 데이터를 함께 보관한다.
     struct M485E_ManualWriteRequest
     {
          long index;
          long startAddress;
          long quantity;
          word data[125];
     };

     // Signal Panel의 공통 입력값이다. Read와 Write 이벤트가 같은 로더를 사용한다.
     struct M485E_SignalRequest
     {
          long index;
          char signalName[128];
          float physicalValue;
     };

     // 마지막 성공 Read는 AutoReadManual이 1초마다 같은 요청을 반복할 때 사용한다.
     struct M485E_ManualReadRequest gM485E_LastReadRequest;
     long gM485E_LastReadValid;
     word gM485E_UIWordData[125];
     long gM485E_UILongData[125];
     long gM485E_ReadOptionValues[200];
     struct M485E_SignalRequest gM485E_SignalRequest;
     // UI 입력 동기화, 자동 Read, DLL 상태 표시를 서로 독립된 타이머로 처리한다.
     msTimer tM485E_ManualAutoRead;
     msTimer tM485E_UISync;
     msTimer tM485E_LifecycleStatus;
     long gM485E_UILifecycleStatus[9];
     // Handle 값과 무관한 DLL 수명주기 상태 전이를 추적한다.
     long gM485E_UILastLifecycleState = -1;
}

// SignalControl 시스템변수의 Index, SignalName, PhysicalValue를 한 번에 복사한다.
// 이벤트 처리 중 Panel 값이 바뀌어도 동일한 요청 묶음을 사용하기 위한 함수이다.
void M485E_UI_LoadSignalRequest()
{
     gM485E_SignalRequest.index = @sysvar::M485E::SignalControl::Index;
     sysGetVariableString(sysvar::M485E::SignalControl::SignalName,
          gM485E_SignalRequest.signalName,
          elcount(gM485E_SignalRequest.signalName));
     gM485E_SignalRequest.physicalValue =
          @sysvar::M485E::SignalControl::PhysicalValue;
}

// Register Read를 실행하고 성공한 word 결과를 Panel용 32-bit int array에 복사한다.
// 성공 요청은 Auto Read용 마지막 요청으로 보관하며 결과 코드는 항상 시스템변수에 기록한다.
// request.quantity는 최대 125이며, 실제 범위 검증은 DLL이 단일 책임으로 수행한다.
long M485E_UI_ExecuteRead(struct M485E_ManualReadRequest request)
{
     long result;
     long index;
     result = M485E_Core_ReadRegisters(request.index, request.startAddress,
          request.quantity, gM485E_UIWordData);
     if (result == M485E_OK)
     {
          for (index = 0; index < request.quantity; index++)
               gM485E_UILongData[index] = gM485E_UIWordData[index];
          sysSetVariableLongArray(sysvar::M485E::ManualRead::Data,
               gM485E_UILongData, request.quantity);
          gM485E_LastReadRequest.index = request.index;
          gM485E_LastReadRequest.startAddress = request.startAddress;
          gM485E_LastReadRequest.quantity = request.quantity;
          gM485E_LastReadValid = 1;
     }
     @sysvar::M485E::ManualRead::ResultCode = result;
     M485E_Core_ReportSyncFailure("ManualRead", result);
     return result;
}

// 준비된 Register Write 요청을 DLL에 전달하고 결과 코드를 Panel에 반영한다.
// request.data는 word 배열이므로 각 원소가 Modbus 16-bit Register 하나에 대응한다.
long M485E_UI_ExecuteWrite(struct M485E_ManualWriteRequest request)
{
     long result;
     result = M485E_Core_WriteRegisters(request.index, request.startAddress,
          request.quantity, request.data);
     @sysvar::M485E::ManualWrite::ResultCode = result;
     M485E_Core_ReportSyncFailure("ManualWrite", result);
     return result;
}

// ConnectSwitch가 바뀌면 모든 활성 Serial Port의 Connect 또는 Disconnect를 요청한다.
on sysvar_update sysvar::M485E::Connection::ConnectSwitch
{
     long result;
     if (@this != 0) result = M485E_Core_Connect();
     else result = M485E_Core_Disconnect();
     @sysvar::M485E::Connection::ResultCode = result;
     M485E_Core_ReportSyncFailure("Connection", result);
}

// Refresh 버튼 이벤트이다. 0은 무시하고 1일 때 CSV 전체 Refresh를 한 번 실행한다.
// 처리 후 @this를 0으로 내려 Panel 버튼을 다음 요청에 다시 사용할 수 있게 한다.
on sysvar_update sysvar::M485E::Connection::Refresh
{
     long result;
     if (@this == 0) return;
     result = M485E_Core_RefreshCsv();
     @sysvar::M485E::Connection::ResultCode = result;
     M485E_Core_ReportSyncFailure("RefreshCsv", result);
     @this = 0;
}

// Manual Read Send 버튼 이벤트이다.
// Panel의 Index, StartAddress, Quantity를 캡처하여 Debug Register Read를 실행한다.
on sysvar_update sysvar::M485E::ManualRead::Send
{
     struct M485E_ManualReadRequest request;
     if (@this == 0) return;
     request.index = @sysvar::M485E::ManualRead::Index;
     request.startAddress = @sysvar::M485E::ManualRead::StartAddress;
     request.quantity = @sysvar::M485E::ManualRead::Quantity;
     M485E_UI_ExecuteRead(request);
     @this = 0;
}

// Manual Write Send 버튼 이벤트이다.
// generic array의 각 32-bit 값을 읽어 0..65535인지 검사한 뒤 word 배열로 변환한다.
// CAPL System Variable 배열은 최소 32-bit이므로 DLL ABI word 배열로 넘기기 전 변환이 필요하다.
on sysvar_update sysvar::M485E::ManualWrite::Send
{
     struct M485E_ManualWriteRequest request;
     long index;
     if (@this == 0) return;
     request.index = @sysvar::M485E::ManualWrite::Index;
     request.startAddress = @sysvar::M485E::ManualWrite::StartAddress;
     request.quantity = @sysvar::M485E::ManualWrite::Quantity;
     sysGetVariableLongArray(sysvar::M485E::ManualWrite::Data,
          gM485E_UILongData, elcount(gM485E_UILongData));
     for (index = 0; index < request.quantity && index < elcount(request.data); index++)
     {
          if (gM485E_UILongData[index] < 0 || gM485E_UILongData[index] > 65535)
          {
               @sysvar::M485E::ManualWrite::ResultCode = M485E_ERR_INVALID_ARGUMENT;
               @this = 0;
               return;
          }
          request.data[index] = gM485E_UILongData[index];
     }
     M485E_UI_ExecuteWrite(request);
     @this = 0;
}

// Signal Read 버튼 이벤트이다. SignalName으로 읽은 물리값을 PhysicalValue에 표시한다.
// 실패하면 기존 PhysicalValue를 유지하고 ResultCode와 상세 오류만 갱신한다.
on sysvar_update sysvar::M485E::SignalControl::Read
{
     long result;
     if (@this == 0) return;
     M485E_UI_LoadSignalRequest();
     result = M485E_Core_ReadSignal(gM485E_SignalRequest.index,
          gM485E_SignalRequest.signalName,
          gM485E_SignalRequest.physicalValue);
     if (result == M485E_OK)
          @sysvar::M485E::SignalControl::PhysicalValue =
          gM485E_SignalRequest.physicalValue;
     @sysvar::M485E::SignalControl::ResultCode = result;
     M485E_Core_ReportSyncFailure("SignalRead", result);
     @this = 0;
}

// Signal Write 버튼 이벤트이다. Panel의 물리값을 Scale/Offset/Type 규칙에 따라 DLL에 쓴다.
on sysvar_update sysvar::M485E::SignalControl::Write
{
     long result;
     if (@this == 0) return;
     M485E_UI_LoadSignalRequest();
     result = M485E_Core_WriteSignal(gM485E_SignalRequest.index,
          gM485E_SignalRequest.signalName,
          gM485E_SignalRequest.physicalValue);
     @sysvar::M485E::SignalControl::ResultCode = result;
     M485E_Core_ReportSyncFailure("SignalWrite", result);
     @this = 0;
}

// Check_ReadOption 전체를 CAPL 후보 상태로 복사한다.
// ReadSwitch ON 직전에도 호출하여 100ms UI 동기화 Timer를 기다리지 않게 한다.
long M485E_UI_SyncReadOptions()
{
     long index;
     long result;
     long readOptionCount;
     sysGetVariableLongArray(sysvar::M485E::Monitoring::Check_ReadOption,
          gM485E_ReadOptionValues, elcount(gM485E_ReadOptionValues));
     readOptionCount = M485E_Monitoring_GetReadOptionCount();
     for (index = 0; index < readOptionCount; index++)
     {
          result = M485E_Monitoring_SetCandidate(index, gM485E_ReadOptionValues[index]);
          if (result != M485E_OK) return result;
     }
     return M485E_OK;
}

// ReadSwitch가 켜지면 최신 ReadOption으로 CAN Monitoring을 시작하고 꺼지면 중지한다.
// 아직 Connected가 아니면 Start 결과를 표시하고, 연결 완료 상태 전이에서 한 번 재시도한다.
on sysvar_update sysvar::M485E::Monitoring::ReadSwitch
{
     long result;
     if (@this != 0)
     {
          result = M485E_UI_SyncReadOptions();
          if (result == M485E_OK) result = M485E_Monitoring_Start();
     }
     else result = M485E_Monitoring_Stop();
     @sysvar::M485E::Monitoring::ResultCode = result;
     M485E_Core_ReportSyncFailure("Monitoring", result);
}

// UI 관련 세 타이머를 시작한다. 실제 Serial 연결 여부와는 독립적으로 상태를 동기화한다.
void M485E_UI_Start()
{
     gM485E_UILastLifecycleState = -1;
     M485E_UI_SyncReadOptions();
     setTimer(tM485E_ManualAutoRead, 1000);
     setTimer(tM485E_UISync, 100);
     setTimer(tM485E_LifecycleStatus, 100);
}

// AutoReadManual이 켜져 있고 성공한 이전 요청이 있으면 1초마다 같은 범위를 다시 읽는다.
on timer tM485E_ManualAutoRead
{
     if (@sysvar::M485E::ManualRead::AutoReadManual != 0 && gM485E_LastReadValid != 0)
          M485E_UI_ExecuteRead(gM485E_LastReadRequest);
     setTimer(tM485E_ManualAutoRead, 1000);
}

// Panel의 Check_ReadOption int array를 100ms마다 Monitoring 후보 상태로 복사한다.
// 실제 적용은 다음 Monitoring Cycle 경계에서 일괄 수행된다.
// Panel에서 여러 CheckBox가 같은 시점에 바뀌어도 다음 Cycle에는 한 묶음으로 반영된다.
on timer tM485E_UISync
{
     M485E_UI_SyncReadOptions();
     setTimer(tM485E_UISync, 100);
}

// DLL 수명주기 상태를 100ms마다 읽어 Panel 표시 변수 세 개를 갱신한다.
// 같은 Tick에서 비동기 오류도 최대 한 건 꺼내 CANalyzer Write 창에 출력한다.
on timer tM485E_LifecycleStatus
{
     long result;
     long monitoringResult;
     long currentState;
     long previousState;
     result = M485E_Core_GetLifecycleStatus(gM485E_UILifecycleStatus);
     if (result == M485E_OK)
     {
          currentState = gM485E_UILifecycleStatus[M485E_LS_STATE];
          previousState = gM485E_UILastLifecycleState;
          @sysvar::M485E::Connection::State =
               currentState;
          @sysvar::M485E::Connection::LastResult =
               gM485E_UILifecycleStatus[M485E_LS_LAST_RESULT];
          @sysvar::M485E::Connection::ConfigurationValid =
               gM485E_UILifecycleStatus[M485E_LS_CONFIGURATION_VALID];
          // Disconnect는 DLL Snapshot Queue를 중지하므로 CAPL Timer 상태도 함께 내린다.
          if (currentState != M485E_STATE_CONNECTED &&
               M485E_Monitoring_IsEnabled() != 0)
          {
               monitoringResult = M485E_Monitoring_Stop();
               @sysvar::M485E::Monitoring::ResultCode = monitoringResult;
               M485E_Core_ReportSyncFailure("MonitoringStop", monitoringResult);
          }
          // ReadSwitch가 미리 ON이었거나 연결 중 -5000이 발생한 경우, Connected 진입 때
          // 최신 후보를 다시 읽고 정확히 한 번 Monitoring을 시작한다.
          if (currentState == M485E_STATE_CONNECTED &&
               previousState != M485E_STATE_CONNECTED &&
               @sysvar::M485E::Monitoring::ReadSwitch != 0 &&
               M485E_Monitoring_IsEnabled() == 0)
          {
               monitoringResult = M485E_UI_SyncReadOptions();
               if (monitoringResult == M485E_OK)
                    monitoringResult = M485E_Monitoring_Start();
               @sysvar::M485E::Monitoring::ResultCode = monitoringResult;
               M485E_Core_ReportSyncFailure("MonitoringStart", monitoringResult);
          }
          gM485E_UILastLifecycleState = currentState;
     }
     M485E_Core_PollOneErrorEvent();
     setTimer(tM485E_LifecycleStatus, 100);
}

// 측정 종료 시 UI 타이머를 모두 취소하여 종료 후 이벤트가 재호출되지 않게 한다.
void M485E_UI_Stop()
{
     cancelTimer(tM485E_ManualAutoRead);
     cancelTimer(tM485E_UISync);
     cancelTimer(tM485E_LifecycleStatus);
}
