/*@!Encoding:949*/

// Core는 CAPL과 DLL 사이의 단일 경계이다.
// Context, ABI 변환, 공통 오류 처리만 담당하며 System Variable, CAN 출력, Timer에 의존하지 않는다.

variables
{
     // CAPL 노드별 DLL Context와 오류 조회용 공용 버퍼이다.
     // Vector Handle은 0도 정상값이므로 등록/초기화 상태는 별도 Flag로 관리한다.
     dword gM485E_ContextHandle;
     long gM485E_ContextRegistered;
     long gM485E_ContextInitialized;
     long gM485E_CoreErrorMeta[20];
     char gM485E_CoreErrorText[1024];
}

/*
 * 함수명: M485E_Core_ReportSyncFailure
 * 기능: 동기 DLL API 실패 시 마지막 상세 오류를 조회하여 Write 창에 출력한다.
 * 파라미터:
 *   operation - Write 창에서 호출 위치를 구분할 문자열
 *   result - 직전에 DLL API가 반환한 결과 코드
 */
void M485E_Core_ReportSyncFailure(char operation[], long result)
{
     long errorResult;
     if (result >= M485E_OK) return;
     errorResult = M485E_Dll_GetLastSyncError(gM485E_ContextHandle,
          elcount(gM485E_CoreErrorMeta),
          gM485E_CoreErrorMeta,
          elcount(gM485E_CoreErrorText),
          gM485E_CoreErrorText);
     if (errorResult == M485E_OK)
          write("M485E %s failed: code=%d severity=%d subsystem=%d stage=%d detail=%s",
          operation, result,
          gM485E_CoreErrorMeta[M485E_EM_SEVERITY],
          gM485E_CoreErrorMeta[M485E_EM_SUBSYSTEM],
          gM485E_CoreErrorMeta[M485E_EM_STAGE], gM485E_CoreErrorText);
     else
          write("M485E %s failed: code=%d", operation, result);
}

/*
 * 함수명: M485E_Core_PollOneErrorEvent
 * 기능: DLL 비동기 오류 Queue에서 이벤트를 최대 한 건 꺼내 Write 창에 출력한다.
 * 파라미터: 없음
 * 반환값: M485E_OK, M485E_STATUS_NO_DATA 또는 DLL 오류 코드
 */
long M485E_Core_PollOneErrorEvent()
{
     long result;
     result = M485E_Dll_TryDequeueErrorEvent(gM485E_ContextHandle,
          elcount(gM485E_CoreErrorMeta),
          gM485E_CoreErrorMeta,
          elcount(gM485E_CoreErrorText),
          gM485E_CoreErrorText);
     if (result == M485E_OK)
          write("M485E async error: sequence=%d code=%d repeat=%d port=%d detail=%s",
          gM485E_CoreErrorMeta[M485E_EM_SEQUENCE],
          gM485E_CoreErrorMeta[M485E_EM_ERROR_CODE],
          gM485E_CoreErrorMeta[M485E_EM_REPEAT_COUNT],
          gM485E_CoreErrorMeta[M485E_EM_PORT_SLOT], gM485E_CoreErrorText);
     return result;
}

/*
 * 함수명: M485E_Core_Initialize
 * 기능: preStart에서 등록한 CAPL Context Handle로 DLL Context를 초기화한다.
 * 파라미터: 없음
 * 반환값: M485E_OK 또는 Context 등록/초기화 오류 코드
 */
long M485E_Core_Initialize()
{
     long result;
     if (gM485E_ContextRegistered == 0) return M485E_ERR_INVALID_CONTEXT;
     result = M485E_Dll_InitializeContext(gM485E_ContextHandle);
     if (result == M485E_OK) gM485E_ContextInitialized = 1;
     return result;
}

/*
 * 함수명: M485E_Core_Finalize
 * 기능: DLL Context가 보유한 Port, Queue 및 작업 자원을 정리한다.
 * 파라미터: 없음
 * 반환값: M485E_OK 또는 DLL Finalize 오류 코드
 */
long M485E_Core_Finalize()
{
     long result;
     if (gM485E_ContextInitialized == 0) return M485E_OK;
     result = M485E_Dll_FinalizeContext(gM485E_ContextHandle);
     if (result == M485E_OK) gM485E_ContextInitialized = 0;
     return result;
}

/*
 * 함수명: M485E_Core_SetCsvPath
 * 기능: Configuration 기준 상대 경로를 절대 경로로 변환하여 DLL에 등록한다.
 * 파라미터:
 *   fileType - M485E_FILE_DEVICE_MAP 또는 M485E_FILE_MODBUS_RULE
 *   relativePath - CANalyzer Configuration을 기준으로 해석할 CSV 경로
 * 반환값: M485E_OK 또는 경로 변환/DLL 검증 오류 코드
 */
long M485E_Core_SetCsvPath(long fileType, char relativePath[])
{
     char absolutePath[1024];
     if (getAbsFilePath(relativePath, absolutePath, elcount(absolutePath)) == -1)
     {
          write("M485E CSV path conversion failed: FileType=%d RelativePath=%s", fileType,
               relativePath);
          return M485E_ERR_CSV_PATH_INVALID;
     }
     write("M485E CSV path: FileType=%d RelativePath=%s AbsolutePath=%s", fileType,
          relativePath, absolutePath);
     return M485E_Dll_SetCsvPath(gM485E_ContextHandle, fileType, strlen(absolutePath),
          absolutePath);
}

/*
 * 함수명: M485E_Core_SetPortConfig
 * 기능: 숫자 COM 번호를 "COMn" 문자열로 변환하여 DLL Port Slot에 설정한다.
 * 파라미터:
 *   portSlot - DLL 내부 Port Slot(0~3)
 *   comPortNumber - Windows COM 번호(1~999)
 *   baudRate - 양수 Baud Rate
 *   dataBits - Serial Data Bit 수
 *   parity - M485E_PARITY_* 상수
 *   stopBits - Stop Bit 수(1 또는 2)
 * 반환값: M485E_OK 또는 Serial 설정 검증 오류 코드
 */
long M485E_Core_SetPortConfig(long portSlot, long comPortNumber, long baudRate,
     long dataBits, long parity, long stopBits)
{
     char port[16];
     if (comPortNumber < 1 || comPortNumber > 999)
          return M485E_ERR_SERIAL_CONFIG_INVALID;
     snprintf(port, elcount(port), "COM%d", comPortNumber);
     return M485E_Dll_SetPortConfig(gM485E_ContextHandle, portSlot, strlen(port),
          port, baudRate, dataBits, parity, stopBits);
}

/*
 * 함수명: M485E_Core_RefreshCsv
 * 기능: 등록된 CSV를 재검증하고 Register 메모리를 Init_Value 기준으로 재구성한다.
 * 파라미터: 없음
 * 반환값: M485E_OK 또는 상태/CSV 검증 오류 코드
 */
long M485E_Core_RefreshCsv()
{
     return M485E_Dll_RefreshCsv(gM485E_ContextHandle);
}

/*
 * 함수명: M485E_Core_Connect
 * 기능: 검증된 설정의 Serial Port를 열고 Modbus RTU Slave 처리를 시작한다.
 * 파라미터: 없음
 * 반환값: 비동기 Connect 접수 결과 코드
 */
long M485E_Core_Connect()
{
     return M485E_Dll_Connect(gM485E_ContextHandle);
}

/*
 * 함수명: M485E_Core_Disconnect
 * 기능: Serial Port와 통신 작업을 중지하되 DLL Context와 설정은 유지한다.
 * 파라미터: 없음
 * 반환값: 비동기 Disconnect 접수 결과 코드
 */
long M485E_Core_Disconnect()
{
     return M485E_Dll_Disconnect(gM485E_ContextHandle);
}

/*
 * 함수명: M485E_Core_GetLifecycleStatus
 * 기능: DLL Lifecycle 상태를 M485E_LS_* Layout의 호출자 버퍼에 채운다.
 * 파라미터: outStatus - 최소 M485E_LIFECYCLE_STATUS_COUNT개의 long 배열
 * 반환값: M485E_OK 또는 출력 버퍼 오류 코드
 */
long M485E_Core_GetLifecycleStatus(long outStatus[])
{
     return M485E_Dll_GetLifecycleStatus(gM485E_ContextHandle, elcount(outStatus), outStatus);
}

/*
 * 함수명: M485E_Core_StartMonitoring
 * 기능: DLL Snapshot 생성 기능을 활성화한다.
 * 파라미터: 없음
 * 반환값: M485E_OK 또는 Lifecycle 상태 오류 코드
 */
long M485E_Core_StartMonitoring()
{
     return M485E_Dll_StartMonitoring(gM485E_ContextHandle);
}

/*
 * 함수명: M485E_Core_StopMonitoring
 * 기능: DLL Snapshot 생성 기능을 비활성화한다.
 * 파라미터: 없음
 * 반환값: M485E_OK 또는 Lifecycle 상태 오류 코드
 */
long M485E_Core_StopMonitoring()
{
     return M485E_Dll_StopMonitoring(gM485E_ContextHandle);
}

/*
 * 함수명: M485E_Core_ReadRuleSnapshot
 * 기능: Device Index와 Rule ID의 현재 Register 묶음을 동기식으로 읽는다.
 * 파라미터:
 *   index - DeviceMap의 장치 Index
 *   ruleId - FrameRule의 Rule_ID
 *   outMeta - M485E_SM_* Layout의 호출자 소유 배열
 *   outRegisters - Rule Quantity를 받을 호출자 소유 word 배열
 * 반환값: M485E_OK 또는 Rule/출력 버퍼 오류 코드
 */
long M485E_Core_ReadRuleSnapshot(long index, long ruleId, long outMeta[],
     word outRegisters[])
{
     return M485E_Dll_ReadRuleSnapshot(gM485E_ContextHandle, index, ruleId,
          elcount(outMeta), outMeta,
          elcount(outRegisters), outRegisters);
}

/*
 * 함수명: M485E_Core_TryDequeueChangeSnapshot
 * 기능: 지정 Port의 값 변경 Snapshot Queue에서 한 건을 꺼낸다.
 * 파라미터:
 *   portSlot - 조회할 DLL Port Slot
 *   outMeta - M485E_SM_* Layout의 호출자 소유 배열
 *   outRegisters - Snapshot Register를 받을 호출자 소유 word 배열
 * 반환값: M485E_OK, M485E_STATUS_NO_DATA 또는 DLL 오류 코드
 */
long M485E_Core_TryDequeueChangeSnapshot(long portSlot, long outMeta[],
     word outRegisters[])
{
     return M485E_Dll_TryDequeueChangeSnapshot(gM485E_ContextHandle, portSlot,
          elcount(outMeta), outMeta,
          elcount(outRegisters), outRegisters);
}

/*
 * 함수명: M485E_Core_GetChangeQueueStats
 * 기능: 지정 Port의 Change Queue 사용량과 누락 통계를 조회한다.
 * 파라미터:
 *   portSlot - 조회할 DLL Port Slot
 *   outStats - M485E Change Queue 통계 Layout을 받을 배열
 * 반환값: M485E_OK 또는 Port/출력 버퍼 오류 코드
 */
long M485E_Core_GetChangeQueueStats(long portSlot, long outStats[])
{
     return M485E_Dll_GetChangeQueueStats(gM485E_ContextHandle, portSlot,
          elcount(outStats), outStats);
}

/*
 * 함수명: M485E_Core_ReadRegisters
 * 기능: Function Code 구분 없이 DLL Register 메모리의 연속 범위를 읽는다.
 * 파라미터:
 *   index - DeviceMap의 장치 Index
 *   startAddress - 첫 Register Address
 *   quantity - 읽을 16-bit Register 개수
 *   outRegisters - 결과를 받을 호출자 소유 word 배열
 * 반환값: M485E_OK 또는 주소/출력 버퍼 오류 코드
 */
long M485E_Core_ReadRegisters(long index, long startAddress, long quantity,
     word outRegisters[])
{
     return M485E_Dll_ReadRegisters(gM485E_ContextHandle, index, startAddress, quantity,
          elcount(outRegisters), outRegisters);
}

/*
 * 함수명: M485E_Core_WriteRegisters
 * 기능: 입력 word 배열의 연속 Register 값을 DLL 메모리에 적용한다.
 * 파라미터:
 *   index - DeviceMap의 장치 Index
 *   startAddress - 첫 Register Address
 *   quantity - 쓸 16-bit Register 개수
 *   inRegisters - 쓸 값을 보관한 word 배열
 * 반환값: M485E_OK 또는 주소/입력 버퍼 오류 코드
 */
long M485E_Core_WriteRegisters(long index, long startAddress, long quantity,
     word inRegisters[])
{
     return M485E_Dll_WriteRegisters(gM485E_ContextHandle, index, startAddress, quantity,
          elcount(inRegisters), inRegisters);
}

/*
 * 함수명: M485E_Core_ResetDevice
 * 기능: 지정 장치의 Register 메모리를 CSV Init_Value 상태로 되돌린다.
 * 파라미터: index - DeviceMap의 장치 Index
 * 반환값: M485E_OK 또는 장치 Index 오류 코드
 */
long M485E_Core_ResetDevice(long index)
{
     return M485E_Dll_ResetDevice(gM485E_ContextHandle, index);
}

/*
 * 함수명: M485E_Core_ReadSignal
 * 기능: 대소문자를 구분하는 SignalName으로 물리값을 읽는다.
 * 파라미터:
 *   index - DeviceMap의 장치 Index
 *   signalName - Register Map의 SignalName
 *   outPhysicalValue - 성공한 물리값을 받을 참조 변수
 * 반환값: M485E_OK 또는 Signal/변환 오류 코드
 */
long M485E_Core_ReadSignal(long index, char signalName[], float& outPhysicalValue)
{
     float abiOutValue[1];
     long result;
     abiOutValue[0] = outPhysicalValue;
     result = M485E_Dll_ReadSignal(gM485E_ContextHandle, index, strlen(signalName),
          signalName, abiOutValue);
     if (result == M485E_OK) outPhysicalValue = abiOutValue[0];
     return result;
}

/*
 * 함수명: M485E_Core_WriteSignal
 * 기능: SignalName의 Type/Scale/Offset 규칙에 따라 물리값을 Register에 쓴다.
 * 파라미터:
 *   index - DeviceMap의 장치 Index
 *   signalName - Register Map의 SignalName
 *   inPhysicalValue - 적용할 물리값
 * 반환값: M485E_OK 또는 Signal/범위/변환 오류 코드
 */
long M485E_Core_WriteSignal(long index, char signalName[], float inPhysicalValue)
{
     return M485E_Dll_WriteSignal(gM485E_ContextHandle, index, strlen(signalName), signalName,
          inPhysicalValue);
}

/*
 * 함수명: M485E_Core_GetLastSyncError
 * 기능: 가장 최근 동기 API 실패의 상세 메타데이터와 문자열을 조회한다.
 * 파라미터:
 *   outMeta - 오류 메타데이터를 받을 long 배열
 *   outText - 오류 설명을 받을 char 배열
 * 반환값: M485E_OK 또는 출력 버퍼 오류 코드
 */
long M485E_Core_GetLastSyncError(long outMeta[], char outText[])
{
     return M485E_Dll_GetLastSyncError(gM485E_ContextHandle, elcount(outMeta), outMeta,
          elcount(outText), outText);
}

/*
 * 함수명: M485E_Core_TryDequeueErrorEvent
 * 기능: 비동기 오류 Queue에서 이벤트 한 건을 꺼낸다.
 * 파라미터:
 *   outMeta - 오류 메타데이터를 받을 long 배열
 *   outText - 오류 설명을 받을 char 배열
 * 반환값: M485E_OK, M485E_STATUS_NO_DATA 또는 출력 버퍼 오류 코드
 */
long M485E_Core_TryDequeueErrorEvent(long outMeta[], char outText[])
{
     return M485E_Dll_TryDequeueErrorEvent(gM485E_ContextHandle, elcount(outMeta), outMeta,
          elcount(outText), outText);
}

/*
 * 함수명: M485E_Core_GetErrorQueueStats
 * 기능: 비동기 오류 Queue의 현재 사용량과 누락 통계를 조회한다.
 * 파라미터: outStats - 오류 Queue 통계 Layout을 받을 long 배열
 * 반환값: M485E_OK 또는 출력 버퍼 오류 코드
 */
long M485E_Core_GetErrorQueueStats(long outStats[])
{
     return M485E_Dll_GetErrorQueueStats(gM485E_ContextHandle, elcount(outStats), outStats);
}
