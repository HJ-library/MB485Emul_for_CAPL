/*@!Encoding:949*/

// Monitoring은 ReadOption, Snapshot의 CAN 변환, Timer와 Port별 스케줄링을 담당한다.
// DLL은 Core Wrapper로만 호출하며 System Variable 선택값은 UI를 통해 전달받는다.

variables
{
     // Panel의 ReadOption 한 칸과 실제 적용 상태를 함께 보관한다.
     // candidate는 다음 Cycle에 적용할 값이고 applied는 현재 송출에 사용 중인 값이다.
     struct M485E_ReadOption
     {
          long configured;
          long index;
          long ruleId;
          long portSlot;
          long candidateEnabled;
          long appliedEnabled;
          long pendingGeneration;
     };

     // 전체 모니터링 스케줄러의 진행 위치와 On/Off 상태를 보관한다.
     struct M485E_MonitoringState
     {
          long readOptionCount;
          long generation;
          long periodicCursor[M485E_PORT_SLOT_COUNT];
          long periodicStartPort;
          long changeStartPort;
          long enabled;
          long candidateDirty;
     };

     // 1초마다 새 주기를 만들고 10ms Pump가 CAN Frame 예산만큼 나누어 출력한다.
     const long M485E_MONITORING_CYCLE_MS = 1000;
     const long M485E_OUTPUT_PUMP_MS = 10;
     const long M485E_MAX_FRAMES_PER_TICK = 66;
     const long M485E_MAX_CHANGE_FRAMES_PER_TICK = 33;
     const long M485E_MAX_READ_OPTIONS = 200;

     // Snapshot 버퍼는 DLL에서 받은 한 Rule의 Header 정보와 Register 값을 임시 보관한다.
     struct M485E_ReadOption gM485E_ReadOptions[200];
     long gM485E_CandidatePortSlots[200];
     struct M485E_MonitoringState gM485E_MonitoringState;
     msTimer tM485E_MonitoringCycle;
     msTimer tM485E_OutputPump;
     message * gM485E_MonitoringMessage;
     long gM485E_SnapshotMeta[11];
     word gM485E_SnapshotRegisters[125];
}

// ReadOption 슬롯에 Device Index와 Rule ID를 등록한다.
// slot은 Panel Check_ReadOption 배열의 위치와 동일하며 최대 200개까지 허용한다.
// 반환: M485E_OK 또는 슬롯/Index/Rule ID 범위 오류.
long M485E_Monitoring_ConfigureReadOption(long slot, long index, long ruleId)
{
     long existingSlot;
     if (slot < 0 || slot >= M485E_MAX_READ_OPTIONS || index < 0 || index > 255 ||
          ruleId < 0 || ruleId > 255)
          return M485E_ERR_READOPTION_INVALID;

     // 슬롯을 앞에서부터 한 번만 등록해야 Panel 배열과 Rule 목록의 위치가 항상 일치한다.
     // 따라서 이미 사용한 슬롯을 덮어쓰거나 중간 슬롯을 건너뛰는 등록은 허용하지 않는다.
     if (slot != gM485E_MonitoringState.readOptionCount)
          return M485E_ERR_READOPTION_INVALID;
     for (existingSlot = 0; existingSlot < gM485E_MonitoringState.readOptionCount;
          existingSlot++)
     {
          if (gM485E_ReadOptions[existingSlot].configured != 0 &&
               gM485E_ReadOptions[existingSlot].index == index &&
               gM485E_ReadOptions[existingSlot].ruleId == ruleId)
               return M485E_ERR_READOPTION_INVALID;
     }

     gM485E_ReadOptions[slot].configured = 1;
     gM485E_ReadOptions[slot].index = index;
     gM485E_ReadOptions[slot].ruleId = ruleId;
     gM485E_ReadOptions[slot].portSlot = -1;
     gM485E_MonitoringState.readOptionCount = slot + 1;
     return M485E_OK;
}

// 현재 등록된 마지막 ReadOption 슬롯까지의 배열 길이를 반환한다.
long M485E_Monitoring_GetReadOptionCount()
{
     return gM485E_MonitoringState.readOptionCount;
}

// CAPL 스케줄러가 실제로 실행 중인지 반환한다.
// DLL 연결 상태와 별도 플래그로 관리하여 Disconnect 후 재연결 시 재시작 여부를 판단한다.
long M485E_Monitoring_IsEnabled()
{
     return gM485E_MonitoringState.enabled;
}

// Panel에서 읽은 선택 상태를 candidate에 기록한다.
// 값이 실제로 바뀐 경우에만 candidateDirty를 세워 다음 Cycle에 일괄 반영한다.
// enabled는 0이면 비활성, 그 외 값은 활성으로 정규화한다.
long M485E_Monitoring_SetCandidate(long slot, long enabled)
{
     if (slot < 0 || slot >= gM485E_MonitoringState.readOptionCount ||
          gM485E_ReadOptions[slot].configured == 0)
          return M485E_ERR_READOPTION_INVALID;
     enabled = enabled != 0;
     if (gM485E_ReadOptions[slot].candidateEnabled != enabled)
     {
          gM485E_ReadOptions[slot].candidateEnabled = enabled;
          gM485E_MonitoringState.candidateDirty = 1;
     }
     return M485E_OK;
}

// 변경된 ReadOption 후보 전체를 한 번에 검증한 뒤 applied 상태로 확정한다.
// 활성 후보의 Snapshot을 미리 읽어 유효성을 확인하며 하나라도 실패하면 적용하지 않는다.
// 전체 검증 후 확정하는 이유는 같은 Panel 조작 묶음이 일부만 적용되는 것을 막기 위해서다.
long M485E_Monitoring_ApplyCandidates()
{
     long slot;
     long result;
     if (gM485E_MonitoringState.candidateDirty == 0) return M485E_OK;
     for (slot = 0; slot < gM485E_MonitoringState.readOptionCount; slot++)
     {
          if (gM485E_ReadOptions[slot].configured != 0 &&
               gM485E_ReadOptions[slot].candidateEnabled != 0)
          {
               result = M485E_Core_ReadRuleSnapshot(gM485E_ReadOptions[slot].index,
                    gM485E_ReadOptions[slot].ruleId,
                    gM485E_SnapshotMeta,
                    gM485E_SnapshotRegisters);
               if (result != M485E_OK) return result;
               gM485E_CandidatePortSlots[slot] =
                    gM485E_SnapshotMeta[M485E_SM_PORT_SLOT];
          }
     }
     for (slot = 0; slot < gM485E_MonitoringState.readOptionCount; slot++)
     {
          gM485E_ReadOptions[slot].appliedEnabled =
               gM485E_ReadOptions[slot].candidateEnabled;
          if (gM485E_ReadOptions[slot].appliedEnabled != 0)
               gM485E_ReadOptions[slot].portSlot = gM485E_CandidatePortSlots[slot];
          if (gM485E_ReadOptions[slot].appliedEnabled == 0)
               gM485E_ReadOptions[slot].pendingGeneration = 0;
     }
     gM485E_MonitoringState.candidateDirty = 0;
     return M485E_OK;
}

// 한 Rule이 사용하는 CAN Frame 수를 계산한다: Header 1개 + Register 4개당 Data 1개.
// quantity: Rule이 포함하는 16-bit Register 개수.
long M485E_Monitoring_FrameCost(long quantity)
{
     return 1 + ((quantity + 3) / 4);
}

// DLL Snapshot 하나를 Extended CAN Header/Data Message 묶음으로 변환해 출력한다.
// prefix 0은 주기 Frame(0x80), 1은 변경 Frame(0x81)을 의미한다.
// Header는 DLC 8 고정이고 Data는 Register를 4개씩 Big-endian Byte 순서로 적재한다.
// meta는 M485E_SM_* Layout이며 registers에는 meta Quantity 이상의 값이 있어야 한다.
void M485E_Monitoring_OutputSnapshot(long meta[], word registers[], long prefix)
{
     long arbitrationId;
     long registerOffset;
     long messageIndex;
     long count;
     long byteIndex;

     if (meta[M485E_SM_PORT_SLOT] < 0 ||
          meta[M485E_SM_PORT_SLOT] >= gM485E_ActivePortCount)
     {
          write("M485E Snapshot rejected: invalid PortSlot=%d ActivePortCount=%d",
               meta[M485E_SM_PORT_SLOT], gM485E_ActivePortCount);
          return;
     }

     // 0x80/0x81은 CAPL Extended ID 내부 표현에서 bit 24의 prefix로 구분한다.
     arbitrationId = ((prefix & 0x01) << 24) |
          ((meta[M485E_SM_DEVICE_INDEX] & 0xFF) << 16) |
          ((meta[M485E_SM_RULE_ID] & 0xFF) << 8) | 1;
     gM485E_MonitoringMessage.CAN =
          gM485E_VirtualCanChannels[meta[M485E_SM_PORT_SLOT]];
     gM485E_MonitoringMessage.ID = mkExtId(arbitrationId);
     gM485E_MonitoringMessage.DLC = 8;
     gM485E_MonitoringMessage.byte(0) = meta[M485E_SM_DEVICE_INDEX];
     gM485E_MonitoringMessage.byte(1) = meta[M485E_SM_SLAVE_ID];
     gM485E_MonitoringMessage.byte(2) = meta[M485E_SM_FUNCTION_CODE];
     gM485E_MonitoringMessage.byte(3) = meta[M485E_SM_SOURCE_TYPE];
     gM485E_MonitoringMessage.byte(4) = (meta[M485E_SM_ADDRESS] >> 8) & 0xFF;
     gM485E_MonitoringMessage.byte(5) = meta[M485E_SM_ADDRESS] & 0xFF;
     gM485E_MonitoringMessage.byte(6) = (meta[M485E_SM_QUANTITY] >> 8) & 0xFF;
     gM485E_MonitoringMessage.byte(7) = meta[M485E_SM_QUANTITY] & 0xFF;
     output(gM485E_MonitoringMessage);

     registerOffset = 0;
     messageIndex = 2;
     while (registerOffset < meta[M485E_SM_QUANTITY])
     {
          count = meta[M485E_SM_QUANTITY] - registerOffset;
          if (count > 4) count = 4;
          arbitrationId = ((prefix & 0x01) << 24) |
               ((meta[M485E_SM_DEVICE_INDEX] & 0xFF) << 16) |
               ((meta[M485E_SM_RULE_ID] & 0xFF) << 8) | messageIndex;
          gM485E_MonitoringMessage.ID = mkExtId(arbitrationId);
          gM485E_MonitoringMessage.DLC = count * 2;
          for (byteIndex = 0; byteIndex < count; byteIndex++)
          {
               gM485E_MonitoringMessage.byte(byteIndex * 2) =
                    (registers[registerOffset + byteIndex] >> 8) & 0xFF;
               gM485E_MonitoringMessage.byte(byteIndex * 2 + 1) =
                    registers[registerOffset + byteIndex] & 0xFF;
          }
          output(gM485E_MonitoringMessage);
          registerOffset = registerOffset + count;
          messageIndex++;
     }
}

// 활성 Port의 Change Queue를 Round-robin으로 확인하여 변경 Snapshot을 최대 한 건 출력한다.
// 성공 시 사용한 Frame 수를 반환하고 다음 호출은 다음 활성 Port부터 시작한다.
// 한 Port의 Burst가 다른 Port의 Change Snapshot을 계속 지연시키지 않도록 시작점을 순환한다.
long M485E_Monitoring_TryOneChange()
{
     long offset;
     long portSlot;
     long result;
     long portCount;
     portCount = gM485E_ActivePortCount;
     if (portCount < 1 || portCount > M485E_PORT_SLOT_COUNT) return 0;
     for (offset = 0; offset < portCount; offset++)
     {
          portSlot = (gM485E_MonitoringState.changeStartPort + offset) % portCount;
          result = M485E_Core_TryDequeueChangeSnapshot(portSlot, gM485E_SnapshotMeta,
               gM485E_SnapshotRegisters);
          if (result == M485E_OK)
          {
               M485E_Monitoring_OutputSnapshot(gM485E_SnapshotMeta,
                    gM485E_SnapshotRegisters, 1);
               gM485E_MonitoringState.changeStartPort = (portSlot + 1) % portCount;
               return M485E_Monitoring_FrameCost(gM485E_SnapshotMeta[M485E_SM_QUANTITY]);
          }
     }
     gM485E_MonitoringState.changeStartPort =
          (gM485E_MonitoringState.changeStartPort + 1) % portCount;
     return 0;
}

// 지정 Port에서 아직 송출하지 않은 Periodic Rule 하나를 찾아 출력한다.
// Port별 Cursor를 성공한 Rule 다음 위치로만 옮겨 Frame 예산 부족 시 같은 Rule을 다음 Tick에 재시도한다.
// 반환: 출력한 CAN Frame 수. 대기 Rule이 없거나 남은 예산으로 출력할 수 없으면 0.
long M485E_Monitoring_TryOnePeriodic(long portSlot, long remainingFrames)
{
     long checked;
     long slot;
     long result;
     long cost;
     if (gM485E_MonitoringState.readOptionCount <= 0 || remainingFrames <= 0)
          return 0;
     for (checked = 0; checked < gM485E_MonitoringState.readOptionCount; checked++)
     {
          slot = (gM485E_MonitoringState.periodicCursor[portSlot] + checked) %
               gM485E_MonitoringState.readOptionCount;
          if (gM485E_ReadOptions[slot].appliedEnabled != 0 &&
               gM485E_ReadOptions[slot].pendingGeneration != 0 &&
               gM485E_ReadOptions[slot].portSlot == portSlot)
          {
               result = M485E_Core_ReadRuleSnapshot(gM485E_ReadOptions[slot].index,
                    gM485E_ReadOptions[slot].ruleId,
                    gM485E_SnapshotMeta,
                    gM485E_SnapshotRegisters);
               if (result != M485E_OK) continue;
               cost = M485E_Monitoring_FrameCost(
                    gM485E_SnapshotMeta[M485E_SM_QUANTITY]);
               if (cost > remainingFrames) return 0;
               M485E_Monitoring_OutputSnapshot(gM485E_SnapshotMeta,
                    gM485E_SnapshotRegisters, 0);
               gM485E_ReadOptions[slot].pendingGeneration = 0;
               gM485E_MonitoringState.periodicCursor[portSlot] =
                    (slot + 1) % gM485E_MonitoringState.readOptionCount;
               return cost;
          }
     }
     return 0;
}

// 10ms마다 호출되는 출력 Pump이다.
// Change Snapshot을 우선 처리한 뒤 Port별 지속 Cursor를 Round-robin으로 순회한다.
// 한 Round에서 활성 Port마다 최대 한 Rule을 처리하고 예산이 남으면 다음 Round를 반복한다.
void M485E_Monitoring_PumpOnce()
{
     long usedFrames;
     long changeFrames;
     long portCount;
     long startPort;
     long offset;
     long portSlot;
     long cost;
     long madeProgress;
     if (gM485E_MonitoringState.enabled == 0) return;

     usedFrames = 0;
     changeFrames = M485E_Monitoring_TryOneChange();
     if (changeFrames <= M485E_MAX_CHANGE_FRAMES_PER_TICK)
          usedFrames = changeFrames;
     portCount = gM485E_ActivePortCount;
     if (portCount < 1 || portCount > M485E_PORT_SLOT_COUNT) return;
     startPort = gM485E_MonitoringState.periodicStartPort % portCount;
     while (usedFrames < M485E_MAX_FRAMES_PER_TICK)
     {
          madeProgress = 0;
          for (offset = 0; offset < portCount; offset++)
          {
               portSlot = (startPort + offset) % portCount;
               cost = M485E_Monitoring_TryOnePeriodic(portSlot,
                    M485E_MAX_FRAMES_PER_TICK - usedFrames);
               if (cost > 0)
               {
                    usedFrames = usedFrames + cost;
                    madeProgress = 1;
               }
          }
          if (madeProgress == 0) break;
          startPort = (startPort + 1) % portCount;
     }
     gM485E_MonitoringState.periodicStartPort =
          (gM485E_MonitoringState.periodicStartPort + 1) % portCount;
}

// 새로운 1초 주기를 시작한다.
// Panel 후보 변경을 먼저 확정하고 활성 Rule에 이번 generation의 송출 대기 표시를 건다.
void M485E_Monitoring_NewCycle()
{
     long slot;
     long result;
     if (gM485E_MonitoringState.enabled == 0) return;
     result = M485E_Monitoring_ApplyCandidates();
     if (result != M485E_OK)
     {
          write("M485E ReadOption candidate rejected: %d", result);
          return;
     }
     gM485E_MonitoringState.generation++;
     // generation 0은 '송출 대기 없음' 표식이므로 wrap 후에도 1부터 다시 사용한다.
     if (gM485E_MonitoringState.generation <= 0)
          gM485E_MonitoringState.generation = 1;
     for (slot = 0; slot < gM485E_MonitoringState.readOptionCount; slot++)
          if (gM485E_ReadOptions[slot].appliedEnabled != 0)
          gM485E_ReadOptions[slot].pendingGeneration =
          gM485E_MonitoringState.generation;
}

// DLL 모니터링을 활성화하고 첫 Cycle 및 두 CAPL 타이머를 시작한다.
long M485E_Monitoring_Start()
{
     long result;
     result = M485E_Core_StartMonitoring();
     if (result != M485E_OK) return result;
     gM485E_MonitoringState.enabled = 1;
     // Refresh 후 Device-to-Port 매핑이 바뀌었을 수 있으므로 활성 후보를 다시 검증한다.
     gM485E_MonitoringState.candidateDirty = 1;
     result = M485E_Monitoring_ApplyCandidates();
     if (result != M485E_OK)
     {
          // 잘못된 ReadOption으로 CAN 타이머만 실행되는 상태를 만들지 않는다.
          gM485E_MonitoringState.enabled = 0;
          M485E_Core_StopMonitoring();
          return result;
     }
     M485E_Monitoring_NewCycle();
     setTimer(tM485E_MonitoringCycle, M485E_MONITORING_CYCLE_MS);
     setTimer(tM485E_OutputPump, M485E_OUTPUT_PUMP_MS);
     return M485E_OK;
}

// CAPL 타이머를 먼저 멈춘 뒤 DLL 모니터링을 비활성화한다.
long M485E_Monitoring_Stop()
{
     gM485E_MonitoringState.enabled = 0;
     cancelTimer(tM485E_MonitoringCycle);
     cancelTimer(tM485E_OutputPump);
     return M485E_Core_StopMonitoring();
}

// 1초 주기 이벤트: 활성 Rule을 다음 송출 대상으로 다시 등록한다.
on timer tM485E_MonitoringCycle
{
     if (gM485E_MonitoringState.enabled == 0) return;
     M485E_Monitoring_NewCycle();
     if (gM485E_MonitoringState.enabled != 0)
          setTimer(tM485E_MonitoringCycle, M485E_MONITORING_CYCLE_MS);
}

// 10ms 주기 이벤트: Change/Periodic Snapshot을 Frame 예산 안에서 CAN으로 출력한다.
on timer tM485E_OutputPump
{
     if (gM485E_MonitoringState.enabled == 0) return;
     M485E_Monitoring_PumpOnce();
     if (gM485E_MonitoringState.enabled != 0)
          setTimer(tM485E_OutputPump, M485E_OUTPUT_PUMP_MS);
}
