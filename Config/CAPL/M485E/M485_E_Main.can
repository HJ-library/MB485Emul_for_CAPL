/*@!Encoding:949*/
includes
{
     // DLL은 Main.can 기준 상위 CAPL/Dll 폴더에서 로드한다.
     // generated 파일은 DLL ABI 상수이고 나머지 cin 파일은 역할별 CAPL 모듈이다.
     #pragma library("..\\Dll\\M485E.dll")
     #include "M485E_Contracts.generated.cin"
     #include "M485_E_Core.cin"
     #include "M485_E_Monitoring.cin"
     #include "M485_E_ReadOption.cin"
     #include "M485_E_UI.cin"
}

variables
{
     // 하나의 RS-485 포트를 설정하는 CAPL 내부 자료형이다.
     // portSlot은 DLL 내부 슬롯(0~3), comPortNumber는 Windows COM 번호이다.
     struct M485E_PortConfig
     {
          long portSlot;
          long comPortNumber;
          long baudRate;
          long dataBits;
          long parity;
          long stopBits;
     };

     // 아래 상대 경로는 CANalyzer 구성 파일 기준으로 절대 경로로 변환되어 DLL에 전달된다.
     char gM485E_DeviceMapPath[128] = ".\\Maps\\M485E\\M485E_Device.csv";
     char gM485E_FrameRulePath[128] = ".\\Maps\\M485E\\M485E_FrameRule.csv";
     struct M485E_PortConfig gM485E_PortConfigs[4];
     // DeviceMap의 고유 Port 수와 같은 값으로 설정한다. 현재 예제는 한 Port를 사용한다.
     long gM485E_ActivePortCount = 1;
     // Port Slot 0~3이 출력할 CANalyzer 가상 CAN 채널 번호이다.
     long gM485E_VirtualCanChannels[4];
     // Connection System Variable의 목표 상태와 비동기 명령 진행 여부를 관리한다.
     // DLL Context Handle은 0도 유효하므로 연결 진행 상태와 혼용하지 않는다.
     msTimer tM485E_ConnectionControl;
     long gM485E_ConnectionStatus[9];
     long gM485E_DesiredConnected;
     long gM485E_ConnectionCommandSent;
     long gM485E_ShuttingDown;
}

// 최대 네 포트의 기본 통신 조건과 가상 CAN 채널을 채운다.
// 회사 환경의 COM 번호나 통신 속도가 다르면 이 함수의 값만 변경한다.
void M485E_Main_InitializePortConfigs()
{
     gM485E_PortConfigs[0].portSlot = 0;
     gM485E_PortConfigs[0].comPortNumber = 11;
     gM485E_PortConfigs[0].baudRate = 115200;
     gM485E_PortConfigs[0].dataBits = 8;
     gM485E_PortConfigs[0].parity = M485E_PARITY_NONE;
     gM485E_PortConfigs[0].stopBits = 1;

     gM485E_PortConfigs[1].portSlot = 1;
     gM485E_PortConfigs[1].comPortNumber = 12;
     gM485E_PortConfigs[1].baudRate = 115200;
     gM485E_PortConfigs[1].dataBits = 8;
     gM485E_PortConfigs[1].parity = M485E_PARITY_NONE;
     gM485E_PortConfigs[1].stopBits = 1;

     gM485E_PortConfigs[2].portSlot = 2;
     gM485E_PortConfigs[2].comPortNumber = 13;
     gM485E_PortConfigs[2].baudRate = 115200;
     gM485E_PortConfigs[2].dataBits = 8;
     gM485E_PortConfigs[2].parity = M485E_PARITY_NONE;
     gM485E_PortConfigs[2].stopBits = 1;

     gM485E_PortConfigs[3].portSlot = 3;
     gM485E_PortConfigs[3].comPortNumber = 14;
     gM485E_PortConfigs[3].baudRate = 115200;
     gM485E_PortConfigs[3].dataBits = 8;
     gM485E_PortConfigs[3].parity = M485E_PARITY_NONE;
     gM485E_PortConfigs[3].stopBits = 1;

     gM485E_VirtualCanChannels[0] = 1;
     gM485E_VirtualCanChannels[1] = 2;
     gM485E_VirtualCanChannels[2] = 3;
     gM485E_VirtualCanChannels[3] = 4;
}

// 준비된 포트 설정 배열을 앞에서부터 DLL에 등록한다.
// 하나라도 실패하면 즉시 해당 오류 코드를 반환하며 뒤 포트는 적용하지 않는다.
// 반환: M485E_OK 또는 최초로 실패한 Port 설정의 오류 코드.
long M485E_Main_ApplyPortConfigs()
{
     long configIndex;
     long result;
     if (gM485E_ActivePortCount < 1 ||
          gM485E_ActivePortCount > elcount(gM485E_PortConfigs))
          return M485E_ERR_PORT_CONFIG_INCOMPLETE;
     for (configIndex = 0; configIndex < gM485E_ActivePortCount; configIndex++)
     {
          result = M485E_Core_SetPortConfig(
               gM485E_PortConfigs[configIndex].portSlot,
               gM485E_PortConfigs[configIndex].comPortNumber,
               gM485E_PortConfigs[configIndex].baudRate,
               gM485E_PortConfigs[configIndex].dataBits,
               gM485E_PortConfigs[configIndex].parity,
               gM485E_PortConfigs[configIndex].stopBits);
          if (result != M485E_OK) return result;
     }
     return M485E_OK;
}

// CAPL 내부 ReadOption, DLL Context, CSV 경로와 Port 설정을 시작 순서대로 준비한다.
// Refresh는 비동기 요청만 접수하므로 실제 완료는 Connection Control Timer가 확인한다.
// 반환: M485E_OK 또는 최초 준비 단계의 오류 코드.
long M485E_Main_Startup()
{
     long result;

     result = M485E_ReadOption_ConfigureAll();
     if (result != M485E_OK)
     {
          write("M485E ReadOption configuration failed: result=%d", result);
          return result;
     }

     result = M485E_Core_Initialize();
     write("M485E DLL initialization: handle=%d result=%d", gM485E_ContextHandle,
          result);
     if (result != M485E_OK) return result;

     // Context가 준비된 뒤 UI Timer를 먼저 시작하면 이후 비동기 Refresh 상태도 Panel에 표시된다.
     M485E_UI_Start();
     result = M485E_Core_SetCsvPath(M485E_FILE_DEVICE_MAP, gM485E_DeviceMapPath);
     if (result == M485E_OK)
          result = M485E_Core_SetCsvPath(M485E_FILE_MODBUS_RULE,
               gM485E_FrameRulePath);
     if (result == M485E_OK) result = M485E_Main_ApplyPortConfigs();
     if (result == M485E_OK) result = M485E_Core_RefreshCsv();
     write("M485E startup configuration: result=%d", result);
     return result;
}

// 연결 제어를 종료하고 Panel Switch를 OFF로 동기화한다.
// result가 실패이면 마지막 동기 오류를 함께 출력한다.
void M485E_Main_StopConnectionControl(long result)
{
     gM485E_DesiredConnected = 0;
     gM485E_ConnectionCommandSent = 0;
     @sysvar::M485E::Connection::ResultCode = result;
     if (result < M485E_OK) M485E_Core_ReportSyncFailure("Connection", result);
     if (@sysvar::M485E::Connection::ConnectSwitch != 0)
          @sysvar::M485E::Connection::ConnectSwitch = 0;
}

// ConnectSwitch 변경은 목표 상태만 기록한다.
// 실제 DLL API 호출은 Connection Control Timer 한 곳에서 수행하여 중복 요청을 방지한다.
on sysvar_update sysvar::M485E::Connection::ConnectSwitch
{
     if (gM485E_ShuttingDown != 0) return;
     gM485E_DesiredConnected = @this != 0;
     gM485E_ConnectionCommandSent = 0;
     if (gM485E_ContextInitialized == 0) return;
     if (gM485E_DesiredConnected != 0)
          setTimer(tM485E_ConnectionControl, 500);
     else
          setTimer(tM485E_ConnectionControl, 1);
}

// 비동기 Refresh와 Connect/Disconnect 완료 상태를 확인하는 단일 연결 제어 Timer이다.
// Connect는 구성 준비 후 한 번만 요청하며 진행 중에는 100ms 간격으로 상태만 확인한다.
on timer tM485E_ConnectionControl
{
     long result;
     long state;
     long activeOperation;
     long lastResult;

     if (gM485E_ShuttingDown != 0) return;
     result = M485E_Core_GetLifecycleStatus(gM485E_ConnectionStatus);
     if (result != M485E_OK)
     {
          M485E_Main_StopConnectionControl(result);
          return;
     }

     state = gM485E_ConnectionStatus[M485E_LS_STATE];
     activeOperation = gM485E_ConnectionStatus[M485E_LS_ACTIVE_OPERATION];
     lastResult = gM485E_ConnectionStatus[M485E_LS_LAST_RESULT];

     if (gM485E_DesiredConnected != 0)
     {
          if (state == M485E_STATE_CONNECTED)
          {
               @sysvar::M485E::Connection::ResultCode = M485E_OK;
               return;
          }
          if (state == M485E_STATE_REFRESHING || state == M485E_STATE_CONNECTING ||
               state == M485E_STATE_DISCONNECTING)
          {
               setTimer(tM485E_ConnectionControl, 100);
               return;
          }
          if (state == M485E_STATE_DISCONNECTED)
          {
               if (gM485E_ConnectionStatus[M485E_LS_CONFIGURATION_VALID] == 0)
               {
                    if (lastResult >= M485E_OK)
                         lastResult = M485E_ERR_CONFIGURATION_NOT_READY;
                    M485E_Main_StopConnectionControl(lastResult);
                    return;
               }
               if (gM485E_ConnectionCommandSent == 0)
               {
                    result = M485E_Core_Connect();
                    @sysvar::M485E::Connection::ResultCode = result;
                    M485E_Core_ReportSyncFailure("Connect", result);
                    if (result != M485E_OK)
                    {
                         M485E_Main_StopConnectionControl(result);
                         return;
                    }
                    gM485E_ConnectionCommandSent = 1;
                    setTimer(tM485E_ConnectionControl, 100);
                    return;
               }

               // 요청을 접수한 뒤 다시 Disconnected로 돌아오면 초기 Connect가 실패한 것이다.
               if (lastResult >= M485E_OK) lastResult = M485E_ERR_CONNECT_FAILED;
               M485E_Main_StopConnectionControl(lastResult);
               return;
          }

          if (lastResult >= M485E_OK) lastResult = M485E_ERR_INVALID_STATE;
          M485E_Main_StopConnectionControl(lastResult);
          return;
     }

     if (state == M485E_STATE_DISCONNECTED || state == M485E_STATE_UNINITIALIZED ||
          state == M485E_STATE_REFRESHING)
          return;
     if (state == M485E_STATE_CONNECTING &&
          activeOperation != M485E_OPERATION_AUTO_RECONNECT)
     {
          // 초기 Connect는 현재 DLL에서 취소할 수 없으므로 완료 직후 Disconnect한다.
          setTimer(tM485E_ConnectionControl, 100);
          return;
     }
     if (state == M485E_STATE_DISCONNECTING)
     {
          setTimer(tM485E_ConnectionControl, 100);
          return;
     }
     if (gM485E_ConnectionCommandSent == 0)
     {
          result = M485E_Core_Disconnect();
          @sysvar::M485E::Connection::ResultCode = result;
          M485E_Core_ReportSyncFailure("Disconnect", result);
          if (result != M485E_OK)
          {
               M485E_Main_StopConnectionControl(result);
               return;
          }
          gM485E_ConnectionCommandSent = 1;
     }
     setTimer(tM485E_ConnectionControl, 100);
}

// 측정 시작 준비 단계: 포트 기본값을 만들고 현재 CAPL Program Node를 DLL에 등록한다.
// Vector 공식 Sample과 같이 registerCAPLDLL은 이벤트 핸들러에서 직접 호출한다.
// CSV 로딩, DLL Context 초기화와 실제 Serial 연결은 아직 수행하지 않는다.
on preStart
{
     M485E_Main_InitializePortConfigs();
     gM485E_DesiredConnected = 0;
     gM485E_ConnectionCommandSent = 0;
     gM485E_ShuttingDown = 0;
     gM485E_ContextRegistered = 0;
     gM485E_ContextInitialized = 0;
     gM485E_ContextHandle = registerCAPLDLL();
     gM485E_ContextRegistered = 1;
     write("M485E DLL registration: stage=preStart handle=%d", gM485E_ContextHandle);
}

// 측정 시작 단계: CAPL/DLL 구성을 적용하고 ConnectSwitch를 자동으로 ON 한다.
// 500ms 뒤 Connection Control Timer가 Refresh 완료 여부를 확인한 후 Serial 연결을 요청한다.
on start
{
     long result;

     result = M485E_Main_Startup();
     @sysvar::M485E::Connection::ResultCode = result;
     if (result == M485E_OK)
     {
          gM485E_DesiredConnected = 1;
          gM485E_ConnectionCommandSent = 0;
          @sysvar::M485E::Connection::ConnectSwitch = 1;
          setTimer(tM485E_ConnectionControl, 500);
     }
     else
     {
          gM485E_DesiredConnected = 0;
          @sysvar::M485E::Connection::ConnectSwitch = 0;
          M485E_Core_ReportSyncFailure("Startup", result);
     }
}

// 측정 종료 단계: CAPL Timer를 먼저 멈추고 DLL Context Finalize로 작업 Thread와 COM을 닫는다.
// 비동기 Disconnect를 별도로 시작하지 않아 종료 시점에 포트가 남는 경합을 피한다.
on stopMeasurement
{
     long result;

     gM485E_ShuttingDown = 1;
     cancelTimer(tM485E_ConnectionControl);
     gM485E_DesiredConnected = 0;
     @sysvar::M485E::Connection::ConnectSwitch = 0;
     M485E_UI_Stop();
     if (gM485E_ContextInitialized != 0 && M485E_Monitoring_IsEnabled() != 0)
          M485E_Monitoring_Stop();
     write("M485E shutdown: finalize begin");
     result = M485E_Core_Finalize();
     write("M485E shutdown: finalize result=%d", result);
}
