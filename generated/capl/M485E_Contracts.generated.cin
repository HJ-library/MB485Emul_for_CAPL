/* Generated by tools/Generate-M485EContracts.ps1. Do not edit. */
variables
{
  const long M485E_OK = 0;
  const long M485E_STATUS_NO_DATA = 1;
  const long M485E_FILE_DEVICE_MAP = 1;
  const long M485E_FILE_MODBUS_RULE = 2;
  const long M485E_FILE_EMULATOR_MAP = 3;
  const long M485E_FILE_TYPE_COUNT = 3;
  const long M485E_PARITY_NONE = 0;
  const long M485E_PARITY_EVEN = 1;
  const long M485E_PARITY_ODD = 2;
  const long M485E_STATE_UNINITIALIZED = 0;
  const long M485E_STATE_DISCONNECTED = 1;
  const long M485E_STATE_REFRESHING = 2;
  const long M485E_STATE_CONNECTING = 3;
  const long M485E_STATE_CONNECTED = 4;
  const long M485E_STATE_DISCONNECTING = 5;
  const long M485E_STATE_ERROR = 6;
  const long M485E_PORT_SLOT_0 = 0;
  const long M485E_PORT_SLOT_1 = 1;
  const long M485E_PORT_SLOT_2 = 2;
  const long M485E_PORT_SLOT_3 = 3;
  const long M485E_PORT_SLOT_COUNT = 4;
  const long M485E_SNAPSHOT_META_VERSION = 1;
  const long M485E_SNAPSHOT_META_COUNT = 11;
  const long M485E_SM_LAYOUT_VERSION = 0;
  const long M485E_SM_FIELD_COUNT = 1;
  const long M485E_SM_SEQUENCE = 2;
  const long M485E_SM_PORT_SLOT = 3;
  const long M485E_SM_DEVICE_INDEX = 4;
  const long M485E_SM_RULE_ID = 5;
  const long M485E_SM_SLAVE_ID = 6;
  const long M485E_SM_FUNCTION_CODE = 7;
  const long M485E_SM_SOURCE_TYPE = 8;
  const long M485E_SM_ADDRESS = 9;
  const long M485E_SM_QUANTITY = 10;
  const long M485E_LIFECYCLE_STATUS_VERSION = 1;
  const long M485E_LIFECYCLE_STATUS_COUNT = 9;
  const long M485E_LS_LAYOUT_VERSION = 0;
  const long M485E_LS_FIELD_COUNT = 1;
  const long M485E_LS_STATE = 2;
  const long M485E_LS_ACTIVE_OPERATION = 3;
  const long M485E_LS_ACTIVE_GENERATION = 4;
  const long M485E_LS_LAST_COMPLETED_OPERATION = 5;
  const long M485E_LS_LAST_COMPLETED_GENERATION = 6;
  const long M485E_LS_LAST_RESULT = 7;
  const long M485E_LS_CONFIGURATION_VALID = 8;
  const long M485E_ERROR_META_VERSION = 1;
  const long M485E_ERROR_META_COUNT = 20;
  const long M485E_EM_LAYOUT_VERSION = 0;
  const long M485E_EM_FIELD_COUNT = 1;
  const long M485E_EM_SEQUENCE = 2;
  const long M485E_EM_ERROR_CODE = 3;
  const long M485E_EM_SEVERITY = 4;
  const long M485E_EM_SUBSYSTEM = 5;
  const long M485E_EM_OPERATION = 6;
  const long M485E_EM_STAGE = 7;
  const long M485E_EM_VALID_MASK = 8;
  const long M485E_EM_REPEAT_COUNT = 9;
  const long M485E_EM_PORT_SLOT = 10;
  const long M485E_EM_DEVICE_INDEX = 11;
  const long M485E_EM_SLAVE_ID = 12;
  const long M485E_EM_RULE_ID = 13;
  const long M485E_EM_ADDRESS = 14;
  const long M485E_EM_QUANTITY = 15;
  const long M485E_EM_FILE_TYPE = 16;
  const long M485E_EM_ROW = 17;
  const long M485E_EM_COLUMN = 18;
  const long M485E_EM_OS_ERROR = 19;
  const long M485E_EM_VALID_PORT_SLOT = 1;
  const long M485E_EM_VALID_DEVICE_INDEX = 2;
  const long M485E_EM_VALID_SLAVE_ID = 4;
  const long M485E_EM_VALID_RULE_ID = 8;
  const long M485E_EM_VALID_ADDRESS = 16;
  const long M485E_EM_VALID_QUANTITY = 32;
  const long M485E_EM_VALID_FILE_TYPE = 64;
  const long M485E_EM_VALID_ROW = 128;
  const long M485E_EM_VALID_COLUMN = 256;
  const long M485E_EM_VALID_OS_ERROR = 512;
  const long M485E_EM_VALID_OUT_TEXT = 1024;
  const long M485E_ERROR_QUEUE_STATS_VERSION = 1;
  const long M485E_ERROR_QUEUE_STATS_COUNT = 11;
  const long M485E_ES_LAYOUT_VERSION = 0;
  const long M485E_ES_FIELD_COUNT = 1;
  const long M485E_ES_PENDING = 2;
  const long M485E_ES_CAPACITY = 3;
  const long M485E_ES_HIGH_WATER_MARK = 4;
  const long M485E_ES_ENQUEUED_COUNT = 5;
  const long M485E_ES_DEQUEUED_COUNT = 6;
  const long M485E_ES_COALESCED_COUNT = 7;
  const long M485E_ES_DROPPED_COUNT = 8;
  const long M485E_ES_OVERFLOW_LATCH = 9;
  const long M485E_ES_LAST_SEQUENCE = 10;
  const long M485E_CHANGE_QUEUE_STATS_VERSION = 1;
  const long M485E_CHANGE_QUEUE_STATS_COUNT = 12;
  const long M485E_CS_LAYOUT_VERSION = 0;
  const long M485E_CS_FIELD_COUNT = 1;
  const long M485E_CS_PORT_SLOT = 2;
  const long M485E_CS_PENDING = 3;
  const long M485E_CS_CAPACITY = 4;
  const long M485E_CS_HIGH_WATER_MARK = 5;
  const long M485E_CS_ENQUEUED_COUNT = 6;
  const long M485E_CS_DEQUEUED_COUNT = 7;
  const long M485E_CS_DROPPED_COUNT = 8;
  const long M485E_CS_SUPPRESSED_COUNT = 9;
  const long M485E_CS_OVERFLOW_LATCH = 10;
  const long M485E_CS_LAST_SEQUENCE = 11;
  const long M485E_SEVERITY_INFO = 0;
  const long M485E_SEVERITY_WARNING = 1;
  const long M485E_SEVERITY_ERROR = 2;
  const long M485E_SEVERITY_CRITICAL = 3;
  const long M485E_SUBSYSTEM_NONE = 0;
  const long M485E_SUBSYSTEM_CORE = 1;
  const long M485E_SUBSYSTEM_CSV = 2;
  const long M485E_SUBSYSTEM_LIFECYCLE = 3;
  const long M485E_SUBSYSTEM_SERIAL = 4;
  const long M485E_SUBSYSTEM_RTU = 5;
  const long M485E_SUBSYSTEM_REGISTER = 6;
  const long M485E_SUBSYSTEM_SIGNAL = 7;
  const long M485E_SUBSYSTEM_MONITORING = 8;
  const long M485E_SUBSYSTEM_DIAGNOSTIC = 9;
  const long M485E_OPERATION_NONE = 0;
  const long M485E_OPERATION_INITIALIZE_CONTEXT = 1;
  const long M485E_OPERATION_FINALIZE_CONTEXT = 2;
  const long M485E_OPERATION_SET_CSV_PATH = 3;
  const long M485E_OPERATION_SET_PORT_CONFIG = 4;
  const long M485E_OPERATION_REFRESH_CSV = 5;
  const long M485E_OPERATION_CONNECT = 6;
  const long M485E_OPERATION_DISCONNECT = 7;
  const long M485E_OPERATION_GET_LIFECYCLE_STATUS = 8;
  const long M485E_OPERATION_START_MONITORING = 9;
  const long M485E_OPERATION_STOP_MONITORING = 10;
  const long M485E_OPERATION_READ_RULE_SNAPSHOT = 11;
  const long M485E_OPERATION_TRY_DEQUEUE_CHANGE_SNAPSHOT = 12;
  const long M485E_OPERATION_GET_CHANGE_QUEUE_STATS = 13;
  const long M485E_OPERATION_READ_REGISTERS = 14;
  const long M485E_OPERATION_WRITE_REGISTERS = 15;
  const long M485E_OPERATION_RESET_DEVICE = 16;
  const long M485E_OPERATION_READ_SIGNAL = 17;
  const long M485E_OPERATION_WRITE_SIGNAL = 18;
  const long M485E_OPERATION_GET_LAST_SYNC_ERROR = 19;
  const long M485E_OPERATION_TRY_DEQUEUE_ERROR_EVENT = 20;
  const long M485E_OPERATION_GET_ERROR_QUEUE_STATS = 21;
  const long M485E_OPERATION_RTU_REQUEST = 100;
  const long M485E_OPERATION_SERIAL_IO = 101;
  const long M485E_OPERATION_MONITORING_WORKER = 102;
  const long M485E_OPERATION_AUTO_RECONNECT = 103;
  const long M485E_STAGE_NONE = 0;
  const long M485E_STAGE_ARGUMENT_VALIDATION = 1;
  const long M485E_STAGE_STATE_VALIDATION = 2;
  const long M485E_STAGE_PREPARE = 3;
  const long M485E_STAGE_OPEN = 4;
  const long M485E_STAGE_READ = 5;
  const long M485E_STAGE_PARSE = 6;
  const long M485E_STAGE_DATA_VALIDATION = 7;
  const long M485E_STAGE_APPLY = 8;
  const long M485E_STAGE_START = 9;
  const long M485E_STAGE_PROCESS = 10;
  const long M485E_STAGE_WRITE = 11;
  const long M485E_STAGE_STOP = 12;
  const long M485E_STAGE_CLOSE = 13;
  const long M485E_STAGE_COPY_OUTPUT = 14;
  const long M485E_STAGE_QUEUE = 15;
  const long M485E_MAX_DEVICE_INDEX = 255;
  const long M485E_MAX_RULE_ID = 255;
  const long M485E_MIN_SLAVE_ID = 1;
  const long M485E_MAX_SLAVE_ID = 247;
  const long M485E_MIN_REGISTER_ADDRESS = 0;
  const long M485E_MAX_REGISTER_ADDRESS = 65535;
  const long M485E_MIN_DIRECT_QUANTITY = 1;
  const long M485E_MAX_DIRECT_QUANTITY = 125;
  const long M485E_MAX_DEVICES = 256;
  const long M485E_MAX_RULES = 200;
  const long M485E_MAX_SIGNALS = 4096;
  const long M485E_MAX_CSV_FILE_BYTES = 4194304;
  const long M485E_MAX_CSV_ROW_BYTES = 4096;
  const long M485E_CHANGE_QUEUE_CAPACITY = 256;
  const long M485E_ERROR_QUEUE_CAPACITY = 256;
  const long M485E_MAX_PATH_LENGTH = 1023;
  const long M485E_MAX_PORT_LENGTH = 31;
  const long M485E_MAX_SIGNAL_NAME_LENGTH = 127;
  const long M485E_MAX_REQUEST_NAME_LENGTH = 127;
  const long M485E_MAX_DEVICE_NAME_LENGTH = 127;
  const long M485E_MAX_CSV_DB_NAME_LENGTH = 255;
  const long M485E_MAX_UNIT_LENGTH = 31;
  const long M485E_MAX_VALUE_TABLE_LENGTH = 1023;
  const long M485E_MAX_ERROR_TEXT_LENGTH = 1023;
  const long M485E_DEVICE_STATE_UNCONFIGURED = 0;
  const long M485E_DEVICE_STATE_DISABLED = 1;
  const long M485E_DEVICE_STATE_DISCONNECTED = 2;
  const long M485E_DEVICE_STATE_AVAILABLE = 3;
  const long M485E_RTU_LOG_STATS_VERSION = 1;
  const long M485E_RTU_LOG_STATS_COUNT = 9;
  const long M485E_RLS_LAYOUT_VERSION = 0;
  const long M485E_RLS_FIELD_COUNT = 1;
  const long M485E_RLS_CAPTURE_ENABLED = 2;
  const long M485E_RLS_PENDING_LINES = 3;
  const long M485E_RLS_IN_FLIGHT = 4;
  const long M485E_RLS_CAPACITY = 5;
  const long M485E_RLS_DROPPED_COUNT = 6;
  const long M485E_RLS_LAST_SEQUENCE = 7;
  const long M485E_RLS_COMPLETED_COUNT = 8;
  const long M485E_OPERATION_SET_DEVICE_COMMUNICATION_ENABLED = 22;
  const long M485E_OPERATION_GET_DEVICE_COMMUNICATION_STATES = 23;
  const long M485E_OPERATION_SET_RTU_LOG_ENABLED = 24;
  const long M485E_OPERATION_TRY_DEQUEUE_RTU_LOG_LINE = 25;
  const long M485E_OPERATION_GET_RTU_LOG_STATS = 26;
  const long M485E_OPERATION_WAIT_RTU_LOG_IDLE = 27;
  const long M485E_RTU_LOG_TRANSACTION_CAPACITY = 256;
  const long M485E_MAX_RTU_LOG_LINE_LENGTH = 1535;
  const long M485E_RTU_LOG_IDLE_TIMEOUT_MS = 2000;
  const long M485E_MAX_RTU_LOG_IDLE_TIMEOUT_MS = 60000;
  const long M485E_ERROR_CODE_COUNT = 93;

  const long M485E_ERR_INVALID_ARGUMENT = -100; // ERR_INVALID_ARGUMENT
  const long M485E_ERR_INVALID_ENUM = -101; // ERR_INVALID_ENUM
  const long M485E_ERR_INVALID_CONTEXT = -102; // ERR_INVALID_CONTEXT
  const long M485E_ERR_NOT_INITIALIZED = -103; // ERR_NOT_INITIALIZED
  const long M485E_ERR_ALREADY_INITIALIZED = -104; // ERR_ALREADY_INITIALIZED
  const long M485E_ERR_BUFFER_TOO_SMALL = -105; // ERR_BUFFER_TOO_SMALL
  const long M485E_ERR_LENGTH_MISMATCH = -106; // ERR_LENGTH_MISMATCH
  const long M485E_ERR_INVALID_STRING = -107; // ERR_INVALID_STRING
  const long M485E_ERR_LIMIT_EXCEEDED = -108; // ERR_LIMIT_EXCEEDED
  const long M485E_ERR_ABI_UNSUPPORTED = -109; // ERR_ABI_UNSUPPORTED
  const long M485E_ERR_CSV_PATH_NOT_SET = -1000; // ERR_CSV_PATH_NOT_SET
  const long M485E_ERR_CSV_PATH_INVALID = -1001; // ERR_CSV_PATH_INVALID
  const long M485E_ERR_CSV_PATH_NOT_LOCAL = -1002; // ERR_CSV_PATH_NOT_LOCAL
  const long M485E_ERR_CSV_OPEN_FAILED = -1003; // ERR_CSV_OPEN_FAILED
  const long M485E_ERR_CSV_READ_FAILED = -1004; // ERR_CSV_READ_FAILED
  const long M485E_ERR_CSV_FILE_TOO_LARGE = -1005; // ERR_CSV_FILE_TOO_LARGE
  const long M485E_ERR_CSV_INVALID_ENCODING = -1010; // ERR_CSV_INVALID_ENCODING
  const long M485E_ERR_CSV_INVALID_FORMAT = -1011; // ERR_CSV_INVALID_FORMAT
  const long M485E_ERR_CSV_HEADER_MISMATCH = -1012; // ERR_CSV_HEADER_MISMATCH
  const long M485E_ERR_CSV_COLUMN_COUNT = -1013; // ERR_CSV_COLUMN_COUNT
  const long M485E_ERR_CSV_REQUIRED_VALUE = -1014; // ERR_CSV_REQUIRED_VALUE
  const long M485E_ERR_CSV_VALUE_PARSE = -1015; // ERR_CSV_VALUE_PARSE
  const long M485E_ERR_CSV_VALUE_RANGE = -1016; // ERR_CSV_VALUE_RANGE
  const long M485E_ERR_CSV_REFERENCE_NOT_FOUND = -1020; // ERR_CSV_REFERENCE_NOT_FOUND
  const long M485E_ERR_CSV_DUPLICATE_DEVICE = -1021; // ERR_CSV_DUPLICATE_DEVICE
  const long M485E_ERR_CSV_DUPLICATE_PORT_SLAVE = -1022; // ERR_CSV_DUPLICATE_PORT_SLAVE
  const long M485E_ERR_CSV_DUPLICATE_RULE = -1023; // ERR_CSV_DUPLICATE_RULE
  const long M485E_ERR_CSV_RULE_RANGE = -1024; // ERR_CSV_RULE_RANGE
  const long M485E_ERR_CSV_SIGNAL_FRAME = -1030; // ERR_CSV_SIGNAL_FRAME
  const long M485E_ERR_CSV_FRAME_OVERLAP = -1031; // ERR_CSV_FRAME_OVERLAP
  const long M485E_ERR_CSV_SIGNAL_OVERLAP = -1032; // ERR_CSV_SIGNAL_OVERLAP
  const long M485E_ERR_CSV_BYTE_ORDER_CONFLICT = -1033; // ERR_CSV_BYTE_ORDER_CONFLICT
  const long M485E_ERR_CSV_DUPLICATE_SIGNAL = -1034; // ERR_CSV_DUPLICATE_SIGNAL
  const long M485E_ERR_CSV_SIGNAL_PARAMETER = -1035; // ERR_CSV_SIGNAL_PARAMETER
  const long M485E_ERR_CSV_INIT_VALUE = -1036; // ERR_CSV_INIT_VALUE
  const long M485E_ERR_CSV_VALIDATION_FAILED = -1090; // ERR_CSV_VALIDATION_FAILED
  const long M485E_ERR_INVALID_STATE = -2000; // ERR_INVALID_STATE
  const long M485E_ERR_OPERATION_BUSY = -2001; // ERR_OPERATION_BUSY
  const long M485E_ERR_CONFIGURATION_NOT_READY = -2002; // ERR_CONFIGURATION_NOT_READY
  const long M485E_ERR_CONFIGURATION_STALE = -2003; // ERR_CONFIGURATION_STALE
  const long M485E_ERR_PORT_CONFIG_INCOMPLETE = -2004; // ERR_PORT_CONFIG_INCOMPLETE
  const long M485E_ERR_REFRESH_FAILED = -2005; // ERR_REFRESH_FAILED
  const long M485E_ERR_CONNECT_FAILED = -2006; // ERR_CONNECT_FAILED
  const long M485E_ERR_DISCONNECT_FAILED = -2007; // ERR_DISCONNECT_FAILED
  const long M485E_ERR_FINALIZE_FAILED = -2008; // ERR_FINALIZE_FAILED
  const long M485E_ERR_AUTO_RECONNECT_EXHAUSTED = -2009; // ERR_AUTO_RECONNECT_EXHAUSTED
  const long M485E_ERR_SERIAL_CONFIG_INVALID = -3000; // ERR_SERIAL_CONFIG_INVALID
  const long M485E_ERR_SERIAL_CONFIG_UNSUPPORTED = -3001; // ERR_SERIAL_CONFIG_UNSUPPORTED
  const long M485E_ERR_SERIAL_OPEN_FAILED = -3002; // ERR_SERIAL_OPEN_FAILED
  const long M485E_ERR_SERIAL_APPLY_CONFIG = -3003; // ERR_SERIAL_APPLY_CONFIG
  const long M485E_ERR_SERIAL_READ_FAILED = -3004; // ERR_SERIAL_READ_FAILED
  const long M485E_ERR_SERIAL_WRITE_FAILED = -3005; // ERR_SERIAL_WRITE_FAILED
  const long M485E_ERR_SERIAL_PARTIAL_WRITE = -3006; // ERR_SERIAL_PARTIAL_WRITE
  const long M485E_ERR_SERIAL_CANCEL_FAILED = -3007; // ERR_SERIAL_CANCEL_FAILED
  const long M485E_ERR_SERIAL_DEVICE_REMOVED = -3008; // ERR_SERIAL_DEVICE_REMOVED
  const long M485E_ERR_SERIAL_WORKER_FAILED = -3009; // ERR_SERIAL_WORKER_FAILED
  const long M485E_ERR_RTU_FRAME_DISCARDED = -3010; // ERR_RTU_FRAME_DISCARDED
  const long M485E_ERR_RTU_RESPONSE_FAILED = -3011; // ERR_RTU_RESPONSE_FAILED
  const long M485E_ERR_RTU_INTERNAL_FAILURE = -3012; // ERR_RTU_INTERNAL_FAILURE
  const long M485E_ERR_DEVICE_NOT_FOUND = -4000; // ERR_DEVICE_NOT_FOUND
  const long M485E_ERR_REGISTER_ADDRESS = -4001; // ERR_REGISTER_ADDRESS
  const long M485E_ERR_REGISTER_QUANTITY = -4002; // ERR_REGISTER_QUANTITY
  const long M485E_ERR_REGISTER_UNALLOCATED = -4003; // ERR_REGISTER_UNALLOCATED
  const long M485E_ERR_REGISTER_ACCESS_DENIED = -4004; // ERR_REGISTER_ACCESS_DENIED
  const long M485E_ERR_REGISTER_WRITE_FAILED = -4005; // ERR_REGISTER_WRITE_FAILED
  const long M485E_ERR_RESET_FAILED = -4006; // ERR_RESET_FAILED
  const long M485E_ERR_SIGNAL_NOT_FOUND = -4010; // ERR_SIGNAL_NOT_FOUND
  const long M485E_ERR_SIGNAL_VALUE_RANGE = -4011; // ERR_SIGNAL_VALUE_RANGE
  const long M485E_ERR_SIGNAL_CONVERSION = -4012; // ERR_SIGNAL_CONVERSION
  const long M485E_ERR_SIGNAL_NON_FINITE = -4013; // ERR_SIGNAL_NON_FINITE
  const long M485E_ERR_SIGNAL_PRECISION_RANGE = -4014; // ERR_SIGNAL_PRECISION_RANGE
  const long M485E_ERR_SIGNAL_RAW_INVALID = -4015; // ERR_SIGNAL_RAW_INVALID
  const long M485E_ERR_MONITORING_STATE = -5000; // ERR_MONITORING_STATE
  const long M485E_ERR_RULE_NOT_FOUND = -5001; // ERR_RULE_NOT_FOUND
  const long M485E_ERR_READOPTION_INVALID = -5002; // ERR_READOPTION_INVALID
  const long M485E_ERR_PERIODIC_BUDGET = -5003; // ERR_PERIODIC_BUDGET
  const long M485E_ERR_SNAPSHOT_VERSION = -5004; // ERR_SNAPSHOT_VERSION
  const long M485E_ERR_OUTPUT_BUDGET_OVERRUN = -5005; // ERR_OUTPUT_BUDGET_OVERRUN
  const long M485E_ERR_OUTPUT_DEADLINE_MISSED = -5006; // ERR_OUTPUT_DEADLINE_MISSED
  const long M485E_ERR_CHANGE_QUEUE_OVERFLOW = -5007; // ERR_CHANGE_QUEUE_OVERFLOW
  const long M485E_ERR_DIAGNOSTIC_VERSION = -6000; // ERR_DIAGNOSTIC_VERSION
  const long M485E_ERR_ERROR_QUEUE_OVERFLOW = -6001; // ERR_ERROR_QUEUE_OVERFLOW
  const long M485E_ERR_ERROR_CONTEXT_UNAVAILABLE = -6002; // ERR_ERROR_CONTEXT_UNAVAILABLE
  const long M485E_ERR_DIAGNOSTIC_LAYOUT = -6003; // ERR_DIAGNOSTIC_LAYOUT
  const long M485E_ERR_INTERNAL_INVARIANT = -7000; // ERR_INTERNAL_INVARIANT
  const long M485E_ERR_INTERNAL_ALLOCATION = -7001; // ERR_INTERNAL_ALLOCATION
  const long M485E_ERR_INTERNAL_EXCEPTION = -7002; // ERR_INTERNAL_EXCEPTION
  const long M485E_ERR_INTERNAL_STATE = -7003; // ERR_INTERNAL_STATE
  const long M485E_ERR_INTERNAL_QUEUE = -7004; // ERR_INTERNAL_QUEUE
  const long M485E_ERR_INTERNAL_WORKER = -7005; // ERR_INTERNAL_WORKER
  const long M485E_ERR_RTU_LOG_FILE_OPEN = -6010; // ERR_RTU_LOG_FILE_OPEN
  const long M485E_ERR_RTU_LOG_FILE_WRITE = -6011; // ERR_RTU_LOG_FILE_WRITE
  const long M485E_ERR_RTU_LOG_IDLE_TIMEOUT = -6012; // ERR_RTU_LOG_IDLE_TIMEOUT

  char M485E_MESSAGE_KEY_INVALID_ARGUMENT[21] = "ERR_INVALID_ARGUMENT";
  char M485E_MESSAGE_KEY_INVALID_ENUM[17] = "ERR_INVALID_ENUM";
  char M485E_MESSAGE_KEY_INVALID_CONTEXT[20] = "ERR_INVALID_CONTEXT";
  char M485E_MESSAGE_KEY_NOT_INITIALIZED[20] = "ERR_NOT_INITIALIZED";
  char M485E_MESSAGE_KEY_ALREADY_INITIALIZED[24] = "ERR_ALREADY_INITIALIZED";
  char M485E_MESSAGE_KEY_BUFFER_TOO_SMALL[21] = "ERR_BUFFER_TOO_SMALL";
  char M485E_MESSAGE_KEY_LENGTH_MISMATCH[20] = "ERR_LENGTH_MISMATCH";
  char M485E_MESSAGE_KEY_INVALID_STRING[19] = "ERR_INVALID_STRING";
  char M485E_MESSAGE_KEY_LIMIT_EXCEEDED[19] = "ERR_LIMIT_EXCEEDED";
  char M485E_MESSAGE_KEY_ABI_UNSUPPORTED[20] = "ERR_ABI_UNSUPPORTED";
  char M485E_MESSAGE_KEY_CSV_PATH_NOT_SET[21] = "ERR_CSV_PATH_NOT_SET";
  char M485E_MESSAGE_KEY_CSV_PATH_INVALID[21] = "ERR_CSV_PATH_INVALID";
  char M485E_MESSAGE_KEY_CSV_PATH_NOT_LOCAL[23] = "ERR_CSV_PATH_NOT_LOCAL";
  char M485E_MESSAGE_KEY_CSV_OPEN_FAILED[20] = "ERR_CSV_OPEN_FAILED";
  char M485E_MESSAGE_KEY_CSV_READ_FAILED[20] = "ERR_CSV_READ_FAILED";
  char M485E_MESSAGE_KEY_CSV_FILE_TOO_LARGE[23] = "ERR_CSV_FILE_TOO_LARGE";
  char M485E_MESSAGE_KEY_CSV_INVALID_ENCODING[25] = "ERR_CSV_INVALID_ENCODING";
  char M485E_MESSAGE_KEY_CSV_INVALID_FORMAT[23] = "ERR_CSV_INVALID_FORMAT";
  char M485E_MESSAGE_KEY_CSV_HEADER_MISMATCH[24] = "ERR_CSV_HEADER_MISMATCH";
  char M485E_MESSAGE_KEY_CSV_COLUMN_COUNT[21] = "ERR_CSV_COLUMN_COUNT";
  char M485E_MESSAGE_KEY_CSV_REQUIRED_VALUE[23] = "ERR_CSV_REQUIRED_VALUE";
  char M485E_MESSAGE_KEY_CSV_VALUE_PARSE[20] = "ERR_CSV_VALUE_PARSE";
  char M485E_MESSAGE_KEY_CSV_VALUE_RANGE[20] = "ERR_CSV_VALUE_RANGE";
  char M485E_MESSAGE_KEY_CSV_REFERENCE_NOT_FOUND[28] = "ERR_CSV_REFERENCE_NOT_FOUND";
  char M485E_MESSAGE_KEY_CSV_DUPLICATE_DEVICE[25] = "ERR_CSV_DUPLICATE_DEVICE";
  char M485E_MESSAGE_KEY_CSV_DUPLICATE_PORT_SLAVE[29] = "ERR_CSV_DUPLICATE_PORT_SLAVE";
  char M485E_MESSAGE_KEY_CSV_DUPLICATE_RULE[23] = "ERR_CSV_DUPLICATE_RULE";
  char M485E_MESSAGE_KEY_CSV_RULE_RANGE[19] = "ERR_CSV_RULE_RANGE";
  char M485E_MESSAGE_KEY_CSV_SIGNAL_FRAME[21] = "ERR_CSV_SIGNAL_FRAME";
  char M485E_MESSAGE_KEY_CSV_FRAME_OVERLAP[22] = "ERR_CSV_FRAME_OVERLAP";
  char M485E_MESSAGE_KEY_CSV_SIGNAL_OVERLAP[23] = "ERR_CSV_SIGNAL_OVERLAP";
  char M485E_MESSAGE_KEY_CSV_BYTE_ORDER_CONFLICT[28] = "ERR_CSV_BYTE_ORDER_CONFLICT";
  char M485E_MESSAGE_KEY_CSV_DUPLICATE_SIGNAL[25] = "ERR_CSV_DUPLICATE_SIGNAL";
  char M485E_MESSAGE_KEY_CSV_SIGNAL_PARAMETER[25] = "ERR_CSV_SIGNAL_PARAMETER";
  char M485E_MESSAGE_KEY_CSV_INIT_VALUE[19] = "ERR_CSV_INIT_VALUE";
  char M485E_MESSAGE_KEY_CSV_VALIDATION_FAILED[26] = "ERR_CSV_VALIDATION_FAILED";
  char M485E_MESSAGE_KEY_INVALID_STATE[18] = "ERR_INVALID_STATE";
  char M485E_MESSAGE_KEY_OPERATION_BUSY[19] = "ERR_OPERATION_BUSY";
  char M485E_MESSAGE_KEY_CONFIGURATION_NOT_READY[28] = "ERR_CONFIGURATION_NOT_READY";
  char M485E_MESSAGE_KEY_CONFIGURATION_STALE[24] = "ERR_CONFIGURATION_STALE";
  char M485E_MESSAGE_KEY_PORT_CONFIG_INCOMPLETE[27] = "ERR_PORT_CONFIG_INCOMPLETE";
  char M485E_MESSAGE_KEY_REFRESH_FAILED[19] = "ERR_REFRESH_FAILED";
  char M485E_MESSAGE_KEY_CONNECT_FAILED[19] = "ERR_CONNECT_FAILED";
  char M485E_MESSAGE_KEY_DISCONNECT_FAILED[22] = "ERR_DISCONNECT_FAILED";
  char M485E_MESSAGE_KEY_FINALIZE_FAILED[20] = "ERR_FINALIZE_FAILED";
  char M485E_MESSAGE_KEY_AUTO_RECONNECT_EXHAUSTED[29] = "ERR_AUTO_RECONNECT_EXHAUSTED";
  char M485E_MESSAGE_KEY_SERIAL_CONFIG_INVALID[26] = "ERR_SERIAL_CONFIG_INVALID";
  char M485E_MESSAGE_KEY_SERIAL_CONFIG_UNSUPPORTED[30] = "ERR_SERIAL_CONFIG_UNSUPPORTED";
  char M485E_MESSAGE_KEY_SERIAL_OPEN_FAILED[23] = "ERR_SERIAL_OPEN_FAILED";
  char M485E_MESSAGE_KEY_SERIAL_APPLY_CONFIG[24] = "ERR_SERIAL_APPLY_CONFIG";
  char M485E_MESSAGE_KEY_SERIAL_READ_FAILED[23] = "ERR_SERIAL_READ_FAILED";
  char M485E_MESSAGE_KEY_SERIAL_WRITE_FAILED[24] = "ERR_SERIAL_WRITE_FAILED";
  char M485E_MESSAGE_KEY_SERIAL_PARTIAL_WRITE[25] = "ERR_SERIAL_PARTIAL_WRITE";
  char M485E_MESSAGE_KEY_SERIAL_CANCEL_FAILED[25] = "ERR_SERIAL_CANCEL_FAILED";
  char M485E_MESSAGE_KEY_SERIAL_DEVICE_REMOVED[26] = "ERR_SERIAL_DEVICE_REMOVED";
  char M485E_MESSAGE_KEY_SERIAL_WORKER_FAILED[25] = "ERR_SERIAL_WORKER_FAILED";
  char M485E_MESSAGE_KEY_RTU_FRAME_DISCARDED[24] = "ERR_RTU_FRAME_DISCARDED";
  char M485E_MESSAGE_KEY_RTU_RESPONSE_FAILED[24] = "ERR_RTU_RESPONSE_FAILED";
  char M485E_MESSAGE_KEY_RTU_INTERNAL_FAILURE[25] = "ERR_RTU_INTERNAL_FAILURE";
  char M485E_MESSAGE_KEY_DEVICE_NOT_FOUND[21] = "ERR_DEVICE_NOT_FOUND";
  char M485E_MESSAGE_KEY_REGISTER_ADDRESS[21] = "ERR_REGISTER_ADDRESS";
  char M485E_MESSAGE_KEY_REGISTER_QUANTITY[22] = "ERR_REGISTER_QUANTITY";
  char M485E_MESSAGE_KEY_REGISTER_UNALLOCATED[25] = "ERR_REGISTER_UNALLOCATED";
  char M485E_MESSAGE_KEY_REGISTER_ACCESS_DENIED[27] = "ERR_REGISTER_ACCESS_DENIED";
  char M485E_MESSAGE_KEY_REGISTER_WRITE_FAILED[26] = "ERR_REGISTER_WRITE_FAILED";
  char M485E_MESSAGE_KEY_RESET_FAILED[17] = "ERR_RESET_FAILED";
  char M485E_MESSAGE_KEY_SIGNAL_NOT_FOUND[21] = "ERR_SIGNAL_NOT_FOUND";
  char M485E_MESSAGE_KEY_SIGNAL_VALUE_RANGE[23] = "ERR_SIGNAL_VALUE_RANGE";
  char M485E_MESSAGE_KEY_SIGNAL_CONVERSION[22] = "ERR_SIGNAL_CONVERSION";
  char M485E_MESSAGE_KEY_SIGNAL_NON_FINITE[22] = "ERR_SIGNAL_NON_FINITE";
  char M485E_MESSAGE_KEY_SIGNAL_PRECISION_RANGE[27] = "ERR_SIGNAL_PRECISION_RANGE";
  char M485E_MESSAGE_KEY_SIGNAL_RAW_INVALID[23] = "ERR_SIGNAL_RAW_INVALID";
  char M485E_MESSAGE_KEY_MONITORING_STATE[21] = "ERR_MONITORING_STATE";
  char M485E_MESSAGE_KEY_RULE_NOT_FOUND[19] = "ERR_RULE_NOT_FOUND";
  char M485E_MESSAGE_KEY_READOPTION_INVALID[23] = "ERR_READOPTION_INVALID";
  char M485E_MESSAGE_KEY_PERIODIC_BUDGET[20] = "ERR_PERIODIC_BUDGET";
  char M485E_MESSAGE_KEY_SNAPSHOT_VERSION[21] = "ERR_SNAPSHOT_VERSION";
  char M485E_MESSAGE_KEY_OUTPUT_BUDGET_OVERRUN[26] = "ERR_OUTPUT_BUDGET_OVERRUN";
  char M485E_MESSAGE_KEY_OUTPUT_DEADLINE_MISSED[27] = "ERR_OUTPUT_DEADLINE_MISSED";
  char M485E_MESSAGE_KEY_CHANGE_QUEUE_OVERFLOW[26] = "ERR_CHANGE_QUEUE_OVERFLOW";
  char M485E_MESSAGE_KEY_DIAGNOSTIC_VERSION[23] = "ERR_DIAGNOSTIC_VERSION";
  char M485E_MESSAGE_KEY_ERROR_QUEUE_OVERFLOW[25] = "ERR_ERROR_QUEUE_OVERFLOW";
  char M485E_MESSAGE_KEY_ERROR_CONTEXT_UNAVAILABLE[30] = "ERR_ERROR_CONTEXT_UNAVAILABLE";
  char M485E_MESSAGE_KEY_DIAGNOSTIC_LAYOUT[22] = "ERR_DIAGNOSTIC_LAYOUT";
  char M485E_MESSAGE_KEY_INTERNAL_INVARIANT[23] = "ERR_INTERNAL_INVARIANT";
  char M485E_MESSAGE_KEY_INTERNAL_ALLOCATION[24] = "ERR_INTERNAL_ALLOCATION";
  char M485E_MESSAGE_KEY_INTERNAL_EXCEPTION[23] = "ERR_INTERNAL_EXCEPTION";
  char M485E_MESSAGE_KEY_INTERNAL_STATE[19] = "ERR_INTERNAL_STATE";
  char M485E_MESSAGE_KEY_INTERNAL_QUEUE[19] = "ERR_INTERNAL_QUEUE";
  char M485E_MESSAGE_KEY_INTERNAL_WORKER[20] = "ERR_INTERNAL_WORKER";
  char M485E_MESSAGE_KEY_RTU_LOG_FILE_OPEN[22] = "ERR_RTU_LOG_FILE_OPEN";
  char M485E_MESSAGE_KEY_RTU_LOG_FILE_WRITE[23] = "ERR_RTU_LOG_FILE_WRITE";
  char M485E_MESSAGE_KEY_RTU_LOG_IDLE_TIMEOUT[25] = "ERR_RTU_LOG_IDLE_TIMEOUT";
}
